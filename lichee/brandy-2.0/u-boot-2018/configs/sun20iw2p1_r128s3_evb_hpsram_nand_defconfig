## lichee/brandy-2.0/u-boot-2018/configs/sun20iw2p1_r128s3_evb_hpsram_nand_defconfig
```kconfig
CONFIG_ARM=y
CONFIG_CPU_V8M=y
CONFIG_ARCH_SUNXI=y
CONFIG_MACH_SUN20IW2=y

CONFIG_DEFAULT_DEVICE_TREE="sun20iw2p1-external-flash"
CONFIG_CONSOLE_MUX=y
CONFIG_PRE_CONSOLE_BUFFER=n
#CONFIG_OF_BOARD=y
CONFIG_OF_SEPARATE=y
CONFIG_SYS_TEXT_BASE=0xd509000
CONFIG_SUNXI_FDT_ADDR=0xd680000
CONFIG_SUNXI_TURNNING_FLASH=y

#system
CONFIG_SUNXI_DMA=y
CONFIG_SUNXI_IMAGE_HEADER=y
CONFIG_SUNXI_SET_DRAM=y
CONFIG_SUNXI_USE_HPSRAM=y
CONFIG_SUNXI_DRAM_SIZE=20
CONFIG_SUNXI_MALLOC_LEN=0x180000

# Environment
CONFIG_ENV_IS_IN_SUNXI_FLASH=y
CONFIG_SYS_MAXARGS=64
CONFIG_SUNXI_REDUNDAND_ENVIRONMENT=y
CONFIG_SYS_REDUNDAND_ENVIRONMENT=y
CONFIG_SUNXI_ENV_PARTITION="env"
CONFIG_SUNXI_ENV_REDUNDAND_PARTITION="env-redund"
CONFIG_ENV_SIZE=0x1000

#SPI
CONFIG_SPI=y
CONFIG_SUNXI_SPI=y
#CONFIG_SPI_USE_DMA=y
#CONFIG_SPI_FLASH=y
#CONFIG_SPI_FLASH_WINBOND=y
#CONFIG_SPI_FLASH_EON=y
#CONFIG_SPI_FLASH_GIGADEVICE=y
#CONFIG_SPI_FLASH_ISSI=y
#CONFIG_SPI_FLASH_MACRONIX=y
#CONFIG_SPI_FLASH_SPANSION=y
#CONFIG_SPI_FLASH_ATMEL=y
#CONFIG_SPI_FLASH_STMICRO=y
#CONFIG_SPI_FLASH_SST=y
#CONFIG_SPI_FLASH_PUYA=y
#CONFIG_SPI_FLASH_FM=y
#CONFIG_SPI_FLASH_USE_4K_SECTORS=y

#CONFIG_SF_DEFAULT_SPEED=50000000
# BIT(12) BIT(13) (SPI_RX_DUAL|SPI_RX_QUAD)
#CONFIG_SF_DEFAULT_MODE=0x3000

#usb otg config
CONFIG_SUNXI_USB=y
CONFIG_SUNXI_EFEX=y
CONFIG_SUNXI_BURN=y
CONFIG_SUNXI_FAST_BURN_KEY=n
#CONFIG_SUNXI_FASTBOOT=y
CONFIG_SUNXI_USB_DETECT=y

#partition
CONFIG_EFI_PARTITION=y

#image
CONFIG_ANDROID_BOOT_IMAGE=y
CONFIG_SUNXI_IMAGE_VERIFIER=y

#sprite
CONFIG_SUNXI_SPRITE=y
CONFIG_SUNXI_SECURE_STORAGE=y
#CONFIG_SUNXI_COMPARE_IMAGE_AND_FLASH=y
#CONFIG_SUNXI_NOR_SPRITE_TIME_OPTIMIZE=y
CONFIG_SUNXI_BOOT_SELECT=y

#secure feature
#CONFIG_SUNXI_SECURE_BOOT=y
CONFIG_SUNXI_KEYBOX=y
CONFIG_SUNXI_TFM=y

#cmd
CONFIG_CMD_SUNXI_SPRITE=y
CONFIG_CMD_SUNXI_EFEX=y
CONFIG_CMD_SUNXI_BURN=y
CONFIG_CMD_GPT=y
#CONFIG_CMD_FAT=y
CONFIG_CMD_FASTBOOT=y
CONFIG_CMD_SUNXI_DMA=y
CONFIG_CMD_PART=y
#CONFIG_CMD_SF=y
#CONFIG_CMD_SF_TEST=y
CONFIG_CMD_MEMORY=y
#CONFIG_CMD_UNZIP=y
#CONFIG_CMD_MD5SUM=y
#CONFIG_CMD_SUNXI_TIMER=y

#CONFIG_SUNXI_RTOS=y
#CONFIG_SUNXI_RTOS_LOGICAL_OFFSET=256
CONFIG_SUNXI_RTOS=y
CONFIG_SUNXI_RTOS_OFFSET1_ENABLE=y
CONFIG_SUNXI_RTOS_OFFSET1=1024
CONFIG_SUNXI_RTOS_OFFSET2_ENABLE=y
CONFIG_SUNXI_RTOS_OFFSET2=5120
CONFIG_SUNXI_RTOS_LOGICAL_OFFSET=10208

#GPT
CONFIG_SUNXI_NOT_BACKUP_GPT=y

# flash
CONFIG_SUNXI_FLASH=y
#CONFIG_SUNXI_SPINOR=y
CONFIG_SUNXI_NAND=y
CONFIG_SUNXI_COMM_NAND_V1=y
#CONFIG_SUNXI_TURNNING_FLASH=y
CONFIG_SPINOR_BOOT0_REDUND_OFFSET=128

#smc
CONFIG_NOT_USE_OPTEE25=y

CONFIG_SUNXI_TURNNING_DRAM=n
CONFIG_SUNXI_TURNNING_FLASH=n

#CONFIG_SUNXI_FPGA_PLATFORM=y

CONFIG_CRYPTO=y
```

## lichee/brandy-2.0/u-boot-2018/configs/sun20iw2p1_rtos_defconfig
```kconfig
CONFIG_ARM=y
CONFIG_CPU_V8M=y
CONFIG_ARCH_SUNXI=y
CONFIG_MACH_SUN20IW2=y

CONFIG_DEFAULT_DEVICE_TREE="sun20iw2p1-soc-rtos"
CONFIG_CONSOLE_MUX=y
CONFIG_PRE_CONSOLE_BUFFER=n
#CONFIG_OF_BOARD=y
CONFIG_OF_SEPARATE=y
CONFIG_SYS_TEXT_BASE=0xc009000
CONFIG_SUNXI_FDT_ADDR=0xc180000

#system
CONFIG_SUNXI_DMA=y
CONFIG_SUNXI_SET_DRAM=y
CONFIG_SUNXI_USE_HPSRAM=y

# Environment
CONFIG_ENV_IS_IN_SUNXI_FLASH=y
CONFIG_SYS_MAXARGS=64
CONFIG_SUNXI_REDUNDAND_ENVIRONMENT=y
CONFIG_SYS_REDUNDAND_ENVIRONMENT=y
CONFIG_SUNXI_ENV_PARTITION="env"
CONFIG_SUNXI_ENV_REDUNDAND_PARTITION="env-redund"
CONFIG_ENV_SIZE=0x1000

#SPI
CONFIG_SPI=y
CONFIG_SUNXI_SPI=y
CONFIG_SPI_USE_DMA=y
CONFIG_SPI_FLASH=y
CONFIG_SPI_FLASH_WINBOND=y
CONFIG_SPI_FLASH_EON=y
CONFIG_SPI_FLASH_GIGADEVICE=y
CONFIG_SPI_FLASH_ISSI=y
CONFIG_SPI_FLASH_MACRONIX=y
CONFIG_SPI_FLASH_SPANSION=y
CONFIG_SPI_FLASH_ATMEL=y
CONFIG_SPI_FLASH_STMICRO=y
CONFIG_SPI_FLASH_SST=y
CONFIG_SPI_FLASH_PUYA=y
CONFIG_SPI_FLASH_FM=y
CONFIG_SPI_FLASH_USE_4K_SECTORS=y

CONFIG_SF_DEFAULT_SPEED=50000000
# BIT(12) BIT(13) (SPI_RX_DUAL|SPI_RX_QUAD)
CONFIG_SF_DEFAULT_MODE=0x3000

#usb otg config
CONFIG_SUNXI_USB=y
CONFIG_SUNXI_EFEX=y
CONFIG_SUNXI_BURN=y
#CONFIG_SUNXI_FASTBOOT=y
CONFIG_SUNXI_USB_DETECT=y

#partition
CONFIG_EFI_PARTITION=y

#image
#CONFIG_ANDROID_BOOT_IMAGE=y

#sprite
CONFIG_SUNXI_SPRITE=y
#CONFIG_SUNXI_SECURE_STORAGE=y
#CONFIG_SUNXI_COMPARE_IMAGE_AND_FLASH=y
#CONFIG_SUNXI_NOR_SPRITE_TIME_OPTIMIZE=y

#secure feature
#CONFIG_SUNXI_SECURE_BOOT=y
#CONFIG_SUNXI_KEYBOX=y

#cmd
CONFIG_CMD_SUNXI_SPRITE=y
CONFIG_CMD_SUNXI_EFEX=y
CONFIG_CMD_SUNXI_BURN=y
CONFIG_CMD_GPT=y
#CONFIG_CMD_FAT=y
CONFIG_CMD_FASTBOOT=y
CONFIG_CMD_SUNXI_DMA=y
CONFIG_CMD_PART=y
CONFIG_CMD_SF=y
CONFIG_CMD_SF_TEST=y
CONFIG_CMD_MEMORY=y
CONFIG_CMD_UNZIP=y
CONFIG_CMD_MD5SUM=y
#CONFIG_CMD_SUNXI_TIMER=y

CONFIG_SUNXI_RTOS=y
CONFIG_SUNXI_RTOS_LOGICAL_OFFSET=256

#GPT
CONFIG_SUNXI_NOT_BACKUP_GPT=y

# flash
CONFIG_SUNXI_SDMMC=y
CONFIG_MMC=y
CONFIG_SUNXI_FLASH=y
CONFIG_SUNXI_SPINOR=y
CONFIG_SPINOR_BOOT0_REDUND_OFFSET=128

#smc
CONFIG_NOT_USE_OPTEE25=y

CONFIG_SUNXI_TURNNING_DRAM=n
CONFIG_SUNXI_TURNNING_FLASH=n

#CONFIG_SUNXI_FPGA_PLATFORM=y
```

## lichee/brandy-2.0/u-boot-2018/drivers/tfm/Kconfig
```kconfig
config SUNXI_TFM
    bool "support TFM"
    default y
    help
        TFM support.
```

## lichee/brandy-2.0/u-boot-2018/melis/Kconfig
```kconfig
config SUNXI_MELIS
	bool "Sunxi Melis support"
	default n
	help
	  Enable support for sunxi Melis

if SUNXI_MELIS
config SUNXI_MELIS_LOGICAL_OFFSET
	int "Melis logical offset"
	default 10208
	help
	  spinor address is offset*512 bytes
endif
```

## lichee/brandy-2.0/u-boot-2018/sprite/Kconfig
```kconfig
menuconfig SUNXI_SPRITE
	bool "Sunxi Sprite support"
	select SUNXI_FLASH
	help
	  Enable support for sunxi efex devices. 

if SUNXI_SPRITE
config SUNXI_SECURE_STORAGE
	bool "Sunxi Sprite Secure Storage"
	help
	  Enable supprot for sunxi secure storage

config SUNXI_SPRITE_CARTOON
	bool "Sunxi Sprite cartoon support"
	select SUNXI_FLASH
	help
	  Enable support for sunxi Sprite cartoon(display)

config SUNXI_SPRITE_RECOVERY
	bool "Sunxi Sprite recovery support"
	depends on SUNXI_SDMMC
	default y
	help
	  Enable support for sunxi Sprite recovery

config SUNXI_NOR_SPRITE_TIME_OPTIMIZE
	bool "Sunxi sprite time optimize for nor"
	default n
	help
	  optimize sprite time for nor flash

config SUNXI_AUTO_UPDATE
	bool "Sunxi auto update support"
	depends on MMC || USB
	default n
	help
	  Enable support for sunxi auto update

config SUNXI_DIGEST_TEST
	bool "Sunxi digest test support"
	default n
	help
	  Enable support for sunxi digest test

config SUNXI_UPDATE_GPT

	bool "Sunxi auto gpt support"
	default n
	help
	  Enable support for sunxi gpt update

choice
	depends on SUNXI_AUTO_UPDATE
	prompt "select update form sdcard or usb disk"
	default UPDATE_FROM_SDCARD

config UPDATE_FROM_SDCARD
	bool "img from sdcard"

config UPDATE_FROM_USB
	bool "img from usb disk"

endchoice
config FW_BURN_UDISK_MIN_SIZE
	hex "UDISK min data length default is 0x800"
	depends on SUNXI_SPRITE || SUNXI_AUTO_UPDATE
	default 0x800
	help
	  set UDISK min data length

config SUNXI_PART_UPDATE
	bool "Sunxi part update support"
	depends on MMC
	default n
	help
	  Enable support for sunxi auto update

config SUNXI_NOT_BACKUP_GPT
	bool "Sunxi not backup gpt"
	default n
	help
	  do not backup gpt in the flash end

config SUNXI_BOOT_SELECT
	bool "Sunxi change brom boot select"
	default n
	help
	  change brom boot select

endif
```

## lichee/dsp/Kconfig
```kconfig
mainmenu "Cadence Xtensa DSP Configuration"

menu "Target options"
source "arch/Kconfig"
endmenu

menu "Kernel options"
source "kernel/Kconfig"
endmenu

menu "Drivers options"
source "drivers/Kconfig"
endmenu

menu "Components options"
source "components/Kconfig"
endmenu

menu "Build System options"

choice
        prompt "Compiler optimization level"
        default CC_OPTIMIZE_FOR_SIZE

config CC_OPTIMIZE_FOR_DEBUG
        bool "Optimization level for (-O0)"
        ---help---
          Choosing this option will pass "-O0" to your compiler to debug.

config CC_OPTIMIZE_FOR_PERFORMANCE_O2
        bool "Optimization level for (-O2)"
        ---help---
          Choosing this option will pass "-O2" to your compiler to optimize
          the kernel yet more for performance.

config CC_OPTIMIZE_FOR_PERFORMANCE_O3
        bool "Optimization level for (-O3)"
        ---help---
          Choosing this option will pass "-O3" to your compiler to optimize
          the kernel yet more for performance.

config CC_OPTIMIZE_FOR_SIZE
        bool "Optimization level for (-Os)"
        ---help---
          Choosing this option will pass "-Os" to your compiler resulting
          in a smaller kernel.

endchoice

config LOG_LEVEL
	int "Log level select"
	range 0 7
	default 7
	---help---
			The log level to print. The bigger the level is, the more log.
			We have the follow log level:

			LOG_LVL_ERROR     3
			LOG_LVL_WARNING   4
			LOG_LVL_INFO      6
			LOG_LVL_DBG       7

config DISABLE_ALL_UART_LOG
    bool "Disable All Uart Log"
	default n

endmenu
```

## lichee/dsp/arch/Kconfig
```kconfig
choice
	prompt "Target SoC platform"
	default ARCH_SUN50IW11

config ARCH_SUN50IW11
	bool "sun50iw11"
	select XTENSA_HIFI4

config ARCH_SUN8IW20
	bool "sun8iw20"
	select XTENSA_HIFI4

config ARCH_SUN20IW2
	bool "sun20iw2"
	select XTENSA_HIFI5

config ARCH_SUN55IW3
	bool "sun55iw3"

config ARCH_SUN60IW1
	bool "sun60iw1"
endchoice

# define arch
config ARCH_DSP
	bool
	default y

config XTENSA_HIFI4
bool
	depends on ARCH_SUN50IW11 || ARCH_SUN8IW20
	default n

config XTENSA_HIFI5
bool
	depends on ARCH_SUN20IW2
	default n

# define include arch dir
config ARCH_PLATFORM
	string
	default "sun8iw20" if ARCH_SUN8IW20
	default "sun20iw2" if ARCH_SUN20IW2
	default "sun50iw11" if ARCH_SUN50IW11
	default "sun55iw3" if ARCH_SUN55IW3
	default "sun60iw1" if ARCH_SUN60IW1

# define the development board
choice
	prompt "Development boards"
	default EVB_PLATFORM

config FPGA_PLATFORM
	bool "FPGA board"

config EVB_PLATFORM
	bool "EVB board"

endchoice

# define DSP core
choice
	prompt "Select DSP core"
	default CORE_DSP0

config CORE_DSP0
	bool "Core 0"

config CORE_DSP1
	bool "Core 1"
	depends on ARCH_SUN50IW11

endchoice

# define dsp core id
config CORE_ID
	string
	default "dsp0" if CORE_DSP0
	default "dsp1" if CORE_DSP1
```

## lichee/dsp/arch/common/configs/sun20iw2p1_dsp0_defconfig
```kconfig
CONFIG_ARCH_SUN20IW2=y
CONFIG_DRIVER_SYSCONFIG=y
# CONFIG_DRIVERS_PRCM is not set
CONFIG_DRIVERS_INTC=y
CONFIG_DRIVERS_GPIO_SHARE_IRQ=y
# CONFIG_DRIVERS_TWI is not set
CONFIG_DRIVERS_MSGBOX=y
CONFIG_DRIVERS_MSGBOX_AMP=y
CONFIG_DRIVERS_HWSPINLOCK=y
CONFIG_SND_CODEC_SUN20IW2_AUDIOCODEC=y
CONFIG_SND_CODEC_AUDIOCODEC_ADC=y
CONFIG_COMPONENTS_AW_TINY_ALSA_LIB=y
CONFIG_COMPONENTS_AW_ALSA_UTILS=y
# CONFIG_STANDBY is not set
# CONFIG_AW_JTAG_DEBUG is not set
CONFIG_MEMTESTER=y
CONFIG_VFPU_TEST=y
CONFIG_VFPU_TEST_CASE1=y
CONFIG_COMPONENTS_MALLOC=y
CONFIG_COMPONENTS_SAFE_PRINTF=y
CONFIG_COMPONENTS_AMP=y
CONFIG_AMP_FUNCCALL_THREADPOOL=y
CONFIG_COMPONENTS_AMP_PM=y
CONFIG_AMP_PMOFM33_STUB=y
CONFIG_AMP_PMOFRV_STUB=y
CONFIG_AMP_PMOFDSP_SERVICE=y
CONFIG_AMP_CONSOLE_STUB=y
CONFIG_AMP_CONSOLE_SERVICE=y
CONFIG_COMPONENTS_AMP_AUDIO=y
CONFIG_AMP_AUDIO_SERVICE=y
CONFIG_AMP_TESTS=y
CONFIG_AMP_TEST_DSP_CALL_M33=y
CONFIG_AMP_TEST_DSP_CALL_RV=y
CONFIG_COMPONENTS_AW_AUDIO_SYSTEM=y
CONFIG_COMPONENTS_AW_AUDIO_SYSTEM_HW=y
CONFIG_COMPONENTS_AW_AUDIO_SYSTEM_HW_PCM=y
CONFIG_COMPONENTS_AW_AUDIO_SYSTEM_TRACK=y
CONFIG_COMPONENTS_AW_AUDIO_SYSTEM_RECORD=y
CONFIG_COMPONENTS_AW_AUDIO_SYSTEM_UTILS=y
CONFIG_COMPONENTS_AW_AUDIO_SYSTEM_PLUGIN=y
CONFIG_COMPONENTS_RPDATA=y
CONFIG_COMPONENTS_RPDATA_DEMO=y
CONFIG_COMPONENTS_RPDATA_AUDIO_DEMO=y
CONFIG_COMPONENTS_OMX_SYSTEM=y
CONFIG_COMPONENTS_OMX_BASE=y
CONFIG_COMPONENTS_OMX_BASE_FILTER=y
CONFIG_COMPONENTS_OMX_BASE_SINK=y
CONFIG_COMPONENTS_OMX_BASE_SOURCE=y
CONFIG_COMPONENTS_OMX_BASE_AUDIO_PORT=y
CONFIG_COMPONENTS_OMX_AUDIO_ECHO_CANCEL=y
CONFIG_COMPONENTS_OMX_DUMP=y
CONFIG_COMPONENTS_OMX_AUDIO_RENDER=y
CONFIG_COMPONENTS_OMX_AUDIO_RECORD=y
CONFIG_COMPONENTS_OMX_AUDIO_UTILS=y
CONFIG_COMPONENTS_PM=y
CONFIG_COMPONENTS_VIRT_LOG=y
CONFIG_COMPONENTS_AW_SYS_CONFIG_SCRIPT=y
CONFIG_COMPONENTS_XTENSA_LIBGLOSS=y
CONFIG_FREERTOS_CLI_CMD_MEM_RW=y
CONFIG_FREERTOS_CLI_CMD_FREE=y
CONFIG_FREERTOS_CLI_CMD_TASK_STATUS=y
CONFIG_FREERTOS_CLI_CMD_FORK=y
CONFIG_FREERTOS_CLI_CMD_TOP=y
CONFIG_COMPONENTS_SPEEXDSP=y
CONFIG_CC_OPTIMIZE_FOR_PERFORMANCE_O2=y
```

## lichee/dsp/arch/common/configs/sun20iw2p1_dsp0_min_defconfig
```kconfig
CONFIG_ARCH_SUN20IW2=y
# CONFIG_DRIVERS_PRCM is not set
CONFIG_DRIVERS_INTC=y
# CONFIG_DRIVERS_TWI is not set
CONFIG_DRIVERS_MSGBOX=y
CONFIG_DRIVERS_MSGBOX_AMP=y
CONFIG_DRIVERS_HWSPINLOCK=y
# CONFIG_DRIVERS_SOUND is not set
# CONFIG_STANDBY is not set
# CONFIG_AW_JTAG_DEBUG is not set
CONFIG_VFPU_TEST=y
CONFIG_VFPU_TEST_CASE1=y
CONFIG_COMPONENTS_MALLOC=y
CONFIG_COMPONENTS_SAFE_PRINTF=y
CONFIG_COMPONENTS_AMP=y
CONFIG_AMP_CONSOLE_STUB=y
CONFIG_AMP_CONSOLE_SERVICE=y
CONFIG_COMPONENTS_RPDATA=y
CONFIG_COMPONENTS_RPDATA_DEMO=y
CONFIG_COMPONENTS_VIRT_LOG=y
CONFIG_COMPONENTS_XTENSA_LIBGLOSS=y
CONFIG_FREERTOS_CLI_CMD_MEM_RW=y
CONFIG_FREERTOS_CLI_CMD_FREE=y
CONFIG_FREERTOS_CLI_CMD_TASK_STATUS=y
CONFIG_FREERTOS_CLI_CMD_FORK=y
CONFIG_FREERTOS_CLI_CMD_TOP=y
CONFIG_CC_OPTIMIZE_FOR_PERFORMANCE_O2=y
```

## lichee/dsp/components/Kconfig
```kconfig
comment "System components"

menu "Allwinner components"

config COMPONENTS_AW
	bool
	default y

source "components/aw/Kconfig"
source "components/common/aw/Kconfig"

endmenu

menu "Thirdparty components"

config COMPONENTS_THIRDPARTY
	bool
	default y

source "components/thirdparty/Kconfig"
source "components/common/thirdparty/Kconfig"

endmenu
```

## lichee/dsp/components/aw/Kconfig
```kconfig
source components/aw/sound/Kconfig
source components/aw/standby/Kconfig
source components/aw/oemhead/Kconfig
source components/aw/backtrace/Kconfig
source components/aw/linux_debug/Kconfig

source components/aw/pm_client/Kconfig
source components/aw/watchpoint/Kconfig

menu "Testbench (for development)"
source components/aw/testbench/Kconfig
endmenu

menu "Miscellaneous Support"
source components/aw/misc/Kconfig
endmenu

source components/aw/malloc/Kconfig
source components/aw/safe_printf/Kconfig
```

## lichee/dsp/components/aw/backtrace/Kconfig
```kconfig
menu "Backtrace Support"

config DEBUG_BACKTRACE
	bool "Enable backtrace for HIFI4/5"
	default y

if DEBUG_BACKTRACE
config DEBUG_BACKTRACE_EXCCAUSE_STR
    bool "Enable backtrace exccuase str"
    default y

endif
endmenu
```

## lichee/dsp/components/aw/linux_debug/Kconfig
```kconfig
menu "Linux Debug Support"

config LINUX_DEBUG
	bool "Allow linux debug for dsp"
	default n

endmenu
```

## lichee/dsp/components/aw/malloc/Kconfig
```kconfig
menu "Malloc Components Support"

config COMPONENTS_MALLOC
    bool "DSP RTOS MALLOC"
    default n
    help
        replace newlibc malloc function witch FreeRTOS malloc function.
endmenu
```

## lichee/dsp/components/aw/misc/Kconfig
```kconfig
config BITOPS_FLS
	bool "Generic bitops fls support (based on Linux)"
	default y
```

## lichee/dsp/components/aw/pm_client/Kconfig
```kconfig
config PM_CLIENT_DSP_WAITI
	bool "support dsp enter waiti mode when system suspend."
	default y
	depends on ARCH_SUN8IW20
	help
		Fixed a BUG that caused a dsp crash due to DRAM entering self-refresh.
```

## lichee/dsp/components/aw/safe_printf/Kconfig
```kconfig
menu "Safe printf Components Support"

config COMPONENTS_SAFE_PRINTF
    bool "use safe printf which support multi-core print"
    default n
    help
        Use safe printf to replace the default printf in libc, the safe printf support multi-core print.
endmenu
```
