## lichee/dsp/components/aw/sound/Kconfig
```kconfig
menu "AW Sound Compenents Only For Dsp"

config COMPONENTS_AW_ALSA_LIB_DSP
	bool "Allwinner alsa library only for dsp"
	depends on DRIVERS_SOUND
	default n
	help
	  This is library package for aw-alsa, only used for Allwinner DSP RTOS.

#source "components/aw/sound/aw-alsa-utils/Kconfig"

config COMPONENTS_AW_ALSA_RPAF
	bool "Allwinner remote process audio framework only for dsp"
	default n
	help
	  This is package for aw-rpaf, only used for Allwinner DSP RTOS.

source "components/aw/sound/aw-rpaf/Kconfig"
source "components/aw/sound/aw-alsa-utils/Kconfig"

config COMPONENTS_AW_ALSA_LIB_TEST_DSP
	bool "Allwinner alsa library test only for dsp"
	depends on COMPONENTS_AW_ALSA_LIB_DSP
	default n
	help
	  This is library package for aw-alsa test, only used for Allwinner DSP RTOS.

endmenu
```

## lichee/dsp/components/aw/sound/aw-alsa-utils/Kconfig
```kconfig
config COMPONENTS_AW_ALSA_UTILS_DSP
	bool "Allwinner alsa dsp utilities"
	depends on COMPONENTS_AW_ALSA_LIB_DSP
	default n
	help
	  This is package for aw-alsa-lib utilities, only used for Allwinner DSP RTOS.

config COMPONENTS_AW_ALSA_UTILS_APLAY_DSP
	bool "Allwinner alsa dsp <aplay>"
	depends on COMPONENTS_AW_ALSA_UTILS_DSP
	default n
	help
	  This is package for aw-alsa-lib utilities, only used for Allwinner DSP RTOS.

config COMPONENTS_AW_ALSA_UTILS_ARECORD_DSP
	bool "Allwinner alsa dsp <arecord>"
	depends on COMPONENTS_AW_ALSA_UTILS_DSP
	default n
	help
	  This is package for aw-alsa-lib utilities, only used for Allwinner DSP RTOS.

config COMPONENTS_AW_ALSA_UTILS_ARECORD_MAD_DSP
	bool "Allwinner alsa dsp <arecord-mad>"
	depends on COMPONENTS_AW_ALSA_UTILS_DSP && SND_PLATFORM_SUNXI_MAD
	default n
	help
	  This is package for aw-alsa-lib utilities, only used for Allwinner DSP RTOS.

config COMPONENTS_AW_ALSA_UTILS_MAD_VAD_DSP
	bool "Allwinner alsa dsp <mad-vad>"
	depends on COMPONENTS_AW_ALSA_UTILS_DSP && SND_PLATFORM_SUNXI_MAD
	default n
	help
	  This is package for aw-alsa-lib utilities, only used for Allwinner DSP RTOS.

config COMPONENTS_AW_ALSA_UTILS_ADUPLEX_DSP
	bool "Allwinner alsa dsp <aduplex>"
	depends on COMPONENTS_AW_ALSA_UTILS_DSP
	default n
	help
	  This is package for aw-alsa-lib utilities, only used for Allwinner DSP RTOS.

config COMPONENTS_AW_ALSA_UTILS_ADUPLEX_SYNC_DSP
	bool "Allwinner alsa dsp <aduplex-sync>"
	depends on COMPONENTS_AW_ALSA_UTILS_DSP
	default n
	help
	  This is package for aw-alsa-lib utilities, only used for Allwinner DSP RTOS.

config COMPONENTS_AW_ALSA_UTILS_AMIXER_DSP
	bool "Allwinner alsa dsp <amixer>"
	depends on COMPONENTS_AW_ALSA_UTILS_DSP
	default n
	help
	  This is package for aw-alsa-lib utilities, only used for Allwinner DSP RTOS.

config COMPONENTS_AW_ALSA_UTILS_BUILTIN_WAV_DSP
	bool "Allwinner alsa dsp builtin wav file"
	depends on COMPONENTS_AW_ALSA_UTILS_APLAY_DSP
	default n
	help
	  This is package for aw-alsa-lib utilities, only used for Allwinner DSP RTOS.

config COMPONENTS_AW_ALSA_UTILS_ALOOP_DSP
	bool "Allwinner alsa dsp <aloop>"
	depends on COMPONENTS_AW_ALSA_UTILS_DSP
	default n
	help
	  This is package for aw-alsa-lib utilities, only used for Allwinner DSP RTOS.
```

## lichee/dsp/components/aw/sound/aw-rpaf/Kconfig
```kconfig
config COMPONENTS_AW_ALSA_RPAF_COMPONENT
	bool "Allwinner rpaf component"
	depends on COMPONENTS_AW_ALSA_RPAF
	default n
	help
		This is package for aw-rpaf, only used for Allwinner DSP RTOS.

config COMPONENTS_AW_ALSA_RPAF_SUBSTREAM
	bool "Allwinner rpaf substream"
	depends on COMPONENTS_AW_ALSA_RPAF && COMPONENTS_AW_ALSA_LIB_DSP
	default n
	help
		This is package for aw-rpaf, only used for Allwinner DSP RTOS.

config COMPONENTS_AW_ALSA_RPAF_MIXER
	bool "Allwinner rpaf mixer"
	depends on COMPONENTS_AW_ALSA_RPAF && COMPONENTS_AW_ALSA_LIB_DSP
	default n
	help
		This is package for aw-rpaf, only used for Allwinner DSP RTOS.

config COMPONENTS_AW_ALSA_RPAF_DEBUG
	bool "Allwinner rpaf debug"
	depends on COMPONENTS_AW_ALSA_RPAF
	default n
	help
		This is package for aw-rpaf, only used for Allwinner DSP RTOS.

config COMPONENTS_AW_ALSA_RPAF_SIMULATOR
	bool "Allwinner rpaf <rpaf_simulator>"
	depends on COMPONENTS_AW_ALSA_RPAF_DEBUG
	default n
	help
		This is package for aw-rpaf, only used for Allwinner DSP RTOS.

config COMPONENTS_AW_ALSA_RPAF_REMOTE_AMP
	int "msgbox remote amp id"
	default 0
	depends on COMPONENTS_AW_ALSA_RPAF
	help
		msgbox remote amp id

config COMPONENTS_AW_ALSA_RPAF_READ_CH
	int "msgbox read channel"
	default 1
	depends on COMPONENTS_AW_ALSA_RPAF
	help
		msgbox read channel

config COMPONENTS_AW_ALSA_RPAF_WRITE_CH
	int "msgbox write channel"
	default 1
	depends on COMPONENTS_AW_ALSA_RPAF
	help
		msgbox write channel
```

## lichee/dsp/components/aw/testbench/Kconfig
```kconfig
config AW_TEST_MEM
	bool "Memory test"
	default n

config AW_TEST_CACHE
	bool "Cache test"
	default n

config AW_TEST_TIMER
	bool "Timer test"
	default n

menu "DSPFREQ option features"

config AW_DSPFREQ
	bool "Get/Set DSP freq."
	default y

config SUPPORT_32K
	bool "support change dsp's freq to 32k"
	default n

config CLOSE_PLL_AUDIO0
	bool "close pll_audio0 when suspend."
	default n

config CLOSE_DXCO
	bool "close 24mdxco when suspend."
	depends on SUPPORT_32K && CLOSE_PLL_AUDIO0
	default n

endmenu

menu "dump reg option features"
config ADJUST_REG
	bool "adujst and dump some reg when suspend."
	default n

config CLOSE_SUART_PIN
	bool "close suart pins(PL8/PL9) when suspend."
	default n

endmenu


config AW_HARDWARE_PERF
	bool "HARDWARE performance"
	select DRIVERS_TIMER
	default n

config AW_JTAG_DEBUG
	bool "Setup JTAG for DSP"
	default y

config JTAG_DEBUG_DSP1
	bool "DSP1 power control for JTAG debugging"
	depends on AW_JTAG_DEBUG
	default y
	---help---
		If we wants to just debug DSP0 through JTAG,
		we must power down DSP1, otherwise it will
		lead to an connection error.

config MEMTESTER
	bool "Memtester (based on Linux)"
	default n

menu "Performance Testing"
source "components/aw/testbench/performance/Kconfig"
endmenu

source "components/aw/testbench/vfpu_test/Kconfig"
```

## lichee/dsp/components/aw/testbench/performance/Kconfig
```kconfig
config AW_PERF_MEM_ACC
	bool "Memory access performance test"
	default n
	depends on DRIVERS_TIMER
```
