## lichee/rtos-hal/hal/source/gpio/Kconfig
```kconfig
menu "GPIO Devices"

config DRIVERS_GPIO
    bool "enable gpio driver"
        default y

config HAL_TEST_GPIO
    bool "enable gpio hal APIs test command"
	depends on DRIVERS_GPIO
        default n

config DRIVERS_GPIO_EX_AW9523
    bool "enable gpio chip aw9523"
        default n

config DRIVERS_GPIO_SHARE_IRQ
    bool "enable amp gpio irq"
        default n

endmenu
```

## lichee/rtos-hal/hal/source/lpuart/Kconfig
```kconfig
menu "LPUART Devices"

config DRIVERS_LPUART
    bool "enable lpuart driver"
        default y

config HAL_TEST_LPUART
    bool "enable lpuart hal APIs test command"
	depends on DRIVERS_LPUART
        default n

config SUNXI_LPUART_REGISTER_LPUART0
    bool "support lpuart0 device"
	depends on DRIVERS_LPUART
        default n

config SUNXI_LPUART_REGISTER_LPUART1
    bool "support lpuart1 device"
	depends on DRIVERS_LPUART
        default n

endmenu
```

## lichee/rtos-hal/hal/source/nand_flash/Kconfig
```kconfig
menu "Nand Flash Devices"

config DRIVERS_NAND_FLASH
    bool "enable nand flash driver"
        default n

endmenu
```

## lichee/rtos-hal/hal/source/smartcard/Kconfig
```kconfig
menu "SMARTCARD Devices"

config DRIVERS_SMARTCARD
    bool "enable smartcard device drivers"
        default n

menu "smartcard device option freatuers"

config DRIVERS_SMARTCARD_FEATURE
    bool "scr device feature 1"
        select DRIVERS_SMARTCARD
        default n

config HAL_TEST_SMARTCARD
   bool "enable smartcard APIs test command"
	default n

endmenu

endmenu
```

## lichee/rtos-hal/hal/source/sound/Kconfig
```kconfig
menu "SOUND Devices"

config DRIVERS_SOUND
	bool "Sound card support"
	default y

if DRIVERS_SOUND

source "drivers/rtos-hal/hal/source/sound/core/Kconfig"
source "drivers/rtos-hal/hal/source/sound/codecs/Kconfig"
source "drivers/rtos-hal/hal/source/sound/platform/Kconfig"
source "drivers/rtos-hal/hal/source/sound/component/Kconfig"
source "drivers/rtos-hal/hal/source/sound/common/Kconfig"

endif # DRIVERS_SOUND

endmenu
```

## lichee/rtos-hal/hal/source/sound/codecs/Kconfig
```kconfig
menu "AllWinner CODEC drivers"

config SND_CODEC_SUN8IW18_AUDIOCODEC
	bool "Allwinner AudioCodec support"
	default n
	select SND_PLATFORM_SUNXI_CPUDAI
	select SND_PLATFORM_SUNXI_PCM
	depends on (ARCH_SUN8IW18P1 || ARCH_SUN8IW18)
	help
	  Select Y to add support the Codec embedded in the Allwinner
	  sun8iw18 and affiliated SoCs.

config SND_CODEC_SUN8IW19_AUDIOCODEC
	bool "Allwinner AudioCodec support"
	default n
	select SND_PLATFORM_SUNXI_CPUDAI
	select SND_PLATFORM_SUNXI_PCM
	depends on (ARCH_SUN8IW19P1 || ARCH_SUN8IW19)
	help
	  Select Y to add support the Codec embedded in the Allwinner
	  sun8iw19 and affiliated SoCs.

config SND_CODEC_SUN8IW20_AUDIOCODEC
	bool "Allwinner AudioCodec support"
	default n
	select SND_PLATFORM_SUNXI_CPUDAI
	select SND_PLATFORM_SUNXI_PCM
	depends on (SOC_SUN20IW1P1 || ARCH_SUN8IW20)
	help
	  Select Y to add support the Codec embedded in the Allwinner
	  sun8iw20 and affiliated SoCs.

config SND_CODEC_SUN20IW2_AUDIOCODEC
	bool "Allwinner AudioCodec support"
	default n
	select SND_PLATFORM_SUNXI_CPUDAI
	select SND_PLATFORM_SUNXI_PCM
	depends on (ARCH_SUN20IW2P1 || ARCH_SUN20IW2)
	help
	  Select Y to add support the Codec embedded in the Allwinner
	  sun20iw2 and affiliated SoCs.

if SND_CODEC_SUN20IW2_AUDIOCODEC
menu "Allwinner AudioCodec Choose"
config SND_CODEC_AUDIOCODEC_DAC
	bool "Allwinner AudioCodec DAC Support"
	default n
	select SND_COMMON_SUNXI_COMMON
	select SND_COMMON_SUNXI_ALG_CFG
	help
	  Select Y to add support for audiocodec dac.

config SND_CODEC_AUDIOCODEC_ADC
	bool "Allwinner AudioCodec ADC Support"
	default n
	select SND_COMMON_SUNXI_COMMON
	help
	  Select Y to add support for audiocodec adc.

config SND_CODEC_AUDIOCODEC_DAC_WITHOUT_ADC_CLK
	bool "remove adc clk operation"
	default n
	depends on SND_CODEC_AUDIOCODEC_DAC
	help
	  Select Y to remove adc clk operation.

config SND_CODEC_AUDIOCODEC_DAC_KEEP_AUDIO_PLL_ON
	bool "keep audio pll on"
	default n
	depends on SND_CODEC_AUDIOCODEC_DAC
	help
	  Select Y to keep audio pll on during standby.
endmenu
endif

config SND_CODEC_DUMMY
	bool "Sunxi dummy codec"
	default n

config SND_CODEC_AC108
	bool "Sunxi AC108 codec"
	default n

config SND_CODEC_AC101S
	bool "Sunxi AC101S codec"
	default n
	select DRIVERS_TWI

endmenu
```

## lichee/rtos-hal/hal/source/spi_camera/Kconfig
```kconfig
menu "SPICAMERA Devices"

config DRIVERS_SPI_CAMERA
    bool "enable spi camera driver"
        default n

menu "spi sensor select"
    depends on DRIVERS_SPI_CAMERA

source "drivers/rtos-hal/hal/source/spi_camera/spi_sensor/Kconfig"
endmenu

config HAL_TEST_SPI_CAMERA
    bool "enable spi camera demo test command"
    depends on DRIVERS_SPI_CAMERA
        default y

endmenu
```

## lichee/rtos-hal/hal/source/spi_camera/spi_sensor/Kconfig
```kconfig
config SPI_CAMERA_BF3901
	bool "sensor bf3901 support"
	default y
	---help---
	  board bf3901 support
```

## lichee/rtos-hal/hal/source/vin/Kconfig
```kconfig
menu "VIN Devices"

config DRIVERS_VIN
    bool "enable vin driver"
    default n

if DRIVERS_VIN
choice
	depends on DRIVERS_VIN
	prompt "select isp work mode"
	default ISP_READ_THRESHOLD

config ISP_READ_THRESHOLD
	bool "read ae threshold from flash"

config ISP_FAST_CONVERGENCE
	bool "use HFR to make AE&AWB fast stability(HFR)"

config ISP_ONLY_HARD_LIGHTADC
	bool "use hard light_adc(GPADC)"

config ISP_HARD_LIGHTADC
	bool "use hard light_adc to make AE&AWB fast stability(GPADC&HFR)"
endchoice

config ISP_NUMBER
	int "isp support number"
	default 1
	range 1 3

menu "sensor driver select"
source "ekernel/drivers/rtos-hal/hal/source/vin/modules/sensor/Kconfig"
endmenu

endif

endmenu
```

## lichee/rtos/Kconfig
```kconfig
#
mainmenu "BitThunder Configuration"

config CONFIGURED
	bool
	default y

config PROJECT_CONFIG
	bool
	option env="PROJECT_CONFIG"
	default n

config PROJECT_DIR
	string
	default "scripts" if !PROJECT_CONFIG
	option env="PROJECT_DIR"

config ARCH_SUN8IW20
	bool

choice
	prompt "Build target sunxi arch"
	default ARCH_SUN8IW18P1

config ARCH_SUN8IW18P1
	bool "sun8iw18p1"

config ARCH_SUN8IW20P1
	bool "sun8iw20p1"
	select ARCH_SUN8IW20

config ARCH_SUN20IW2P1
	bool "sun20iw2p1"
	select ARCH_SUN20IW2

config ARCH_SUN55IW3P1
	bool "sun55iw3p1"
	select ARCH_SUN55IW3

config ARCH_SUN60IW1P1
	bool "sun60iw1p1"
	select ARCH_SUN60IW1
endchoice

choice
	prompt "Build OS or Library"
	default OS

config OS
	bool "OS"

config LIB
	bool "Library"

endchoice

menu "Build System (dbuild)"

config DBUILD_PYTHON
	string "Python path"
	default "/usr/bin/python"
	---help---
	DBUILD uses Python to form pretty output. Ensure it has a valid python
	interpreter path here.

choice
	prompt "Build Host Platform"
	default HOST_LINUX

config HOST_LINUX
	bool "Linux"

config HOST_WINDOWS
	bool "Windows"

config HOST_OTHER
	bool "Other"

endchoice

config TOOLCHAIN
	string "Toolchain prefix"
	default "tools/gcc-arm-melis-eabi-8-2019-q3-update/bin/arm-melis-eabi-"


choice
	prompt "Optimisation Level"
	default OPTIMISE_SIZE

config OPTIMISE_NONE
	bool "No Optimisations"

config OPTIMISE_SIZE
    bool "-Os (Optimise for size)"

config OPTIMISE_SPEED
	bool "-O2 (Optimise for speed)"

config OPTIMISE_ULTRA_SPEED
	bool "-O3 (Optimise for ultra-speed (can increase code-size))"

endchoice

config READABLE_ASM
	bool "Generate readable assembler code"
	help
          Disable some compiler optimizations that tend to generate human unreadable
          assembler output. This may make the kernel slightly slower, but it helps
          to keep kernel developers who have to stare a lot at assembler listings
          sane.

choice
	prompt "Warning Level"
	default WARN_NORMAL

config WARN_NORMAL
	bool "Normal warnings from compiler"

config WARN_ALL
	bool "-Wall on compiler"

config WARN_PEDANTIC
	bool "-Wall --pedantic"

config WARN_ERROR
	bool "-Wall -Werror"

config WARN_ERROR_PEDANTIC
	bool "-Wall -Werror --pedantic (For the insane)"

endchoice

config TOOLCHAIN_WARNING
	string
	default ""				if WARN_NORMAL
	default	"-Wall"				if WARN_ALL
	default "-Wall --pedantic"		if WARN_PEDANTIC
	default "-Wall -Werror"			if WARN_ERROR
	default "-Wall -Werror --pedantic" 	if WARN_ERROR_PEDANTIC

config TOOLCHAIN_OPTIMISATION
	string
	default "-Os" if OPTIMISE_SIZE
	default "-O0" if OPTIMISE_NONE
	default "-O2" if OPTIMISE_SPEED
	default "-O3" if OPTIMISE_ULTRA_SPEED

config TOOLCHAIN_DEBUG
	bool "Debug Symbols"
	default y

config TOOLCHAIN_DEBUG_FLAGS
	string
	default "-g" if TOOLCHAIN_DEBUG

config NEWLIBC_NANOSPECS
	bool "newlibc specs flags"
	default n
	help
		"It means use --specs=nano.specs for gcc"

if NEWLIBC_NANOSPECS

config NEWLIBC_NANO_PRINTF_FLOAT
    bool "newlibc nano printf float"
	default n

config NEWLIBC_NANO_SCANF_FLOAT
    bool "newlibc nano scanf float"
	default n

endif

choice
	prompt "Windows Build Environment"
	default WINDOWS_CYGWIN
	depends on HOST_WINDOWS

config WINDOWS_NATIVE
	bool "Windows Native"
	---help---
		Build natively in a CMD.exe environment with Windows style paths (like C:\cgywin\home)

config WINDOWS_CYGWIN
	bool "Cygwin"
	---help---
		Build natively in a Cygwin environment with POSIX style paths (like /cygdrive/c/cgywin/home)

config WINDOWS_MSYS
	bool "MSYS"
	---help---
		Build natively in a Cygwin environment with POSIX style paths (like /cygdrive/c/cgywin/home)

config WINDOWS_OTHER
	bool "Windows POSIX-like environment"
	---help---
		Build natively in another POSIX-like environment.  Additional support may be necessary

endchoice

config LOG_LEVEL
	int "log level"
	range 0 7
	default 7
	---help---
		The log level to print. The bigger the level is, the more log.
		We have the follow log level:

		LOG_LVL_ERROR     3
		LOG_LVL_WARNING   4
		LOG_LVL_INFO      6
		LOG_LVL_DBG       7

config CHECK_ILLEGAL_FUNCTION_USAGE
    bool "check illegal function usage"
    default n

menu "Build Configuration"

config BUILD_NOSTDLIB
	   bool "Disable stdlib linking"
	   default y
	   ---help---
	   Should be enabled for a pure standalone kernel.

config BUILD_GC_UNUSED
	   bool "Removed unused code/data"
	   default y
	   ---help---
	   Asks the linker to always remove unused data/code from the kernel.

config BUILD_DISASSEMBLE
	   bool "Create Assembly listing"
	   default y

config BUILD_DISASSEMBLE_SOURCE
	   bool "Source code in listing"
	   depends on BUILD_DISASSEMBLE
	   default n

endmenu

endmenu

menu "Architecture Options"
source arch/Kconfig
endmenu

menu "Kernel Options"
source kernel/Kconfig
endmenu

menu "Drivers Options"
source drivers/Kconfig
endmenu

menu "System components"
source components/Kconfig
endmenu

menu "Projects Options"
source projects/Kconfig
endmenu
```

## lichee/rtos/arch/Kconfig
```kconfig
choice
	prompt "CPU Architecture"
	default ARCH_ARM

config ARCH_ARM
	bool "ARM"
	---help---
	The ARM architectures

config ARCH_RISCV
	bool "RISCV"
	---help---
	The RISC-V architecture

endchoice

config ARCH
	string
	default "arm"		if ARCH_ARM
	default "risc-v"	if ARCH_RISCV

config ARCH_START_ADDRESS
    hex "CPU Start Address"
    default 0x04000000
    ---help---
    The CPU Bootup Address

config ARCH_MEM_LENGTH
    hex "Memory Length"
    default 0x100000
    ---help---
    The memory length which is used by the CPU.

config ARCH_RISCV_START_ADDRESS
    hex "RISCV CPU Start Address"
    default 0x04000000
    depends on ARCH_ARM
    ---help---
    The RISCV CPU Bootup Address

config ARCH_DSP_START_ADDRESS
    hex "DSP CPU Start Address"
    default 0x04000000
    depends on ARCH_ARM
    ---help---
    The DSP CPU Bootup Address

config BIG_ENDIAN
    bool

config LITTLE_ENDIAN
    bool

config BITS_PER_LONG
    int "bit per long"
    default 32 if ARCH_ARM || ARCH_RISCV_RV32 || ARCH_XTENSA
    default 64 if ARCH_RISCV_RV64

config CACHE_ALIGN_CHECK
	bool "cache align check"
	default y

config TOOLCHAIN_FLOAT_HARD
    bool

config TOOLCHAIN_FLOAT_SOFTFP
    bool

config TOOLCHAIN_FLOAT_SOFT
    bool

config TOOLCHAIN_FLOAT_NONE
    bool

config PANIC_CLI
    bool "Enter CLI When Crash"
    default y

if PANIC_CLI
config PANIC_CLI_PWD
    bool "Panic CLI Password"
    default y

endif

config DISABLE_ALL_UART_LOG
    bool "Disable All Uart Log"
    depends on !PANIC_CLI
    default n

source arch/arm/Kconfig
source arch/risc-v/Kconfig
```

## lichee/rtos/arch/arm/Kconfig
```kconfig
#
# For a description of the syntax of this configuration file,
# see misc/tools/kconfig-language.txt.
#

if ARCH_ARM

comment "ARM Options"

menu "sunxi platform"

config ARCH_SUN20IW2
	bool "allwinner sun20iw2"
	select ARCH_ARM_CORTEX_M33
	default n

config ARCH_SUN8IW18
	bool "allwinner sun8iw18"
	select ARCH_ARM_CORTEX_A7
	default n

config ARCH_SUN8IW20
	bool "allwinner sun8iw20"
	select ARCH_ARM_CORTEX_A7
	default n

endmenu

config ARCH_ARM_CORTEX_M33
	bool
	select LITTLE_ENDIAN
	select ARCH_ARM_ARMV8M

config ARCH_ARM_CORTEX_A7
	bool
	default n
	select LITTLE_ENDIAN
	select ARCH_ARM_ARMV7A

config ARCH_ARM_FAMILY
	string
	default "-march=armv8-m.main -mfpu=fpv5-sp-d16"	if ARCH_ARM_CORTEX_M33
	default "-march=armv7ve"	if ARCH_ARM_CORTEX_A7

config ARCH_ARM_ARMV8M
    bool

config ARCH_ARM_ARMV7A
    bool

config TOOLCHAIN_CPU
	string
	default "-mtune=cortex-m33"	if ARCH_ARM_CORTEX_M33
	default "-mtune=cortex-a7"     if ARCH_ARM_CORTEX_A7

choice
	prompt "Floating point ARM ABI"
	default TOOLCHAIN_ARM_FLOAT_SOFT

config TOOLCHAIN_ARM_FLOAT_HARD
	bool "hardfp"
	select TOOLCHAIN_FLOAT_HARD

config TOOLCHAIN_ARM_FLOAT_SOFTFP
	bool "softfp"
	select TOOLCHAIN_FLOAT_SOFTFP

config TOOLCHAIN_ARM_FLOAT_SOFT
	bool "soft"
	select TOOLCHAIN_FLOAT_SOFT

endchoice

config TOOLCHAIN_MACH_FLAGS
	string
	default "-mthumb -mtune=cortex-m33" if ARCH_ARM_CORTEX_M33
	default "-mcpu=cortex-a7" if ARCH_ARM_CORTEX_A7

config TOOLCHAIN_MFPU
	string
	default "-mfpu=neon-vfpv4" if ARCH_ARM_HAS_NEON

config TOOLCHAIN_FPU_ABI
	string
	default "-mfloat-abi=soft" if TOOLCHAIN_FLOAT_SOFT
	default "-mfloat-abi=softfp" if TOOLCHAIN_FLOAT_SOFTFP
	default "-mfloat-abi=hard" if TOOLCHAIN_FLOAT_HARD

config TOOLCHAIN_OTHER_FLAGS
	string "Toolchain Other Flags"
	default ""

config ARCH_ARM_HAS_NEON
	bool "support neon"
	default n

config ARCH_ARM_BOOT
	bool
	default n

config ARCH_ARM_FPU
	bool "FPU support"
	default y
	depends on ARCH_CORTEXM33
	---help---
		Build in support for the ARM Cortex-M4 Floating Point Unit (FPU).
		Check your chip specifications first; not all Cortex-M4 chips support the FPU.

config ARCH_HAVE_MPU
	bool "MPU Support"
	select ARM_MPU
	default n

config ARCH_HAVE_MMU
    bool "MMU Support"
	default n

config ARM_MPU
    bool

config ARM_MPU_NREGIONS
	int "MMU Region Num"
	depends on ARM_MPU
	default 8

config ARCH_HAVE_DCACHE
    bool "DCache Support"
	default n

config ARCH_HAVE_ICACHE
    bool "ICache Support"
	default n

source arch/arm/armv8m/Kconfig

endif
```
