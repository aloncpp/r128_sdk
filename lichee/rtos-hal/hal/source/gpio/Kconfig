## lichee/rtos/arch/arm/armv8m/Kconfig
```kconfig
if ARCH_ARM_ARMV8M

config CPU_CM33F
	bool "support CM33F feature"
	default n
	help
		Say y to support CM33F feature, such as MSPLIMIT/PSPLIMIT.

config ARCH_ARM_ARMV8M_IRQ_DEFAULT_PRIORITY
	int "IRQ Default Priority"
	default 4
	help
		* It is recommended to set default priority value
		* greater than 1, otherwise it may cause the interrupt
		* to be unshielded and cause the system to be abnormal.

config VECTOR_TABLE_ALIGNMENT
	hex "Interrupt vector table alignment"
	default 0x400
	help
		This configuration is the address alignment of interrupt vector table.
		You must align the offset to the number of exception entries in the vector table.
		It default align to 1024(0x400) byte boundary(support max 256 exception).
		The minimun alignment is 32 words(128 bytes), enough for up to 16 interrupts.
		For more interrupts, adjust the alignment by rounding up to the next power of two.
		For example, if you require 21 interrupts, the alignment must be on a 64-word boundary
		because the required table size is 37 words, and the next power of two is 64.

config ARCH_ARMV8M_DEFAULT_BOOT_RISCV
	bool "default boot riscv"
	default n
	help
		default boot riscv

config ARCH_ARMV8M_DEFAULT_BOOT_DSP
	bool "default boot dsp"
	default n
	help
		default boot dsp

menu "xradio sys config"

choice
	prompt "Select Wlan Clk Src"
	default WLAN_CLK_BY_RFIP0_DPLL
	help
		select clock source for ck_160_wlan(160M)

config WLAN_CLK_BY_RFIP0_DPLL
	bool "rfip0_dpll"

config WLAN_CLK_BY_RFIP1_DPLL
	bool "rfip1_dpll"
endchoice

choice
	prompt "Select Bt Clk Src"
	default BT_CLK_BY_RFIP0_DPLL
	help
		select clock source for ck_192_bt(192M)

config BT_CLK_BY_RFIP0_DPLL
	bool "rfip0_dpll"

config BT_CLK_BY_RFIP1_DPLL
	bool "rfip1_dpll"
endchoice

endmenu

source arch/arm/armv8m/sun20iw2p1/Kconfig

endif
```

## lichee/rtos/arch/arm/armv8m/sun20iw2p1/Kconfig
```kconfig
if ARCH_SUN20IW2P1

config POWER_FALL_PROTECTION
	bool "power fail protection"
	default n
	help
		When vbat drops to 2.7V, SoC will reset to prevent the system working
		in the wrong voltage.

config USE_EXTERNAL_LOW_FREQ_CRYSTAL_CLK
	bool "Use the external low frequency crystal clock"
	default n
	help
		Use the external low frequency crystal clock. After enable this config,
		the clock source of sys_32k, sysrtc_32k and ble_32k will be
		the external low frequency crystal.
endif
```

## lichee/rtos/arch/risc-v/Kconfig
```kconfig
#
# For a description of the syntax of this configuration file,
# see misc/tools/kconfig-language.txt.
#

if ARCH_RISCV

comment "RISCV Options"

menu "sunxi platform"

config ARCH_SUN20IW2
	bool "allwinner sun20iw2"
	select ARCH_RISCV_C906
	default n

config ARCH_SUN55IW3
	bool "allwinner sun55iw3"
	select ARCH_RISCV_E906
	default n

config ARCH_SUN60IW1
	bool "allwinner sun60iw1"
	select ARCH_RISCV_E906
	default n

endmenu

config ARCH_RISCV_C906
	bool
	select ARCH_RISCV_RV64
	select LITTLE_ENDIAN

config ARCH_RISCV_E906
	bool
	select ARCH_RISCV_RV32
	select LITTLE_ENDIAN

config ARCH_RISCV_RV64
	bool

config ARCH_RISCV_RV32
	bool

config TOOLCHAIN_CPU
	string
	default ""

choice
	prompt "Floating point ABI"
	default TOOLCHAIN_RISCV_FLOAT_SOFT

config TOOLCHAIN_RISCV_FLOAT_HARD
	bool "hardfp"
	select TOOLCHAIN_FLOAT_HARD

config TOOLCHAIN_RISCV_FLOAT_SOFTFP
	bool "softfp"
	select TOOLCHAIN_FLOAT_SOFTFP

config TOOLCHAIN_RISCV_FLOAT_SOFT
	bool "soft"
	select TOOLCHAIN_FLOAT_SOFT

config TOOLCHAIN_RISCV_FLOAT_NONE
	bool "none"
	select TOOLCHAIN_FLOAT_NONE

endchoice


config TOOLCHAIN_MACH_FLAGS
	string "toolchain arch cflags"
	default "-mcmodel=medany -mabi=lp64dv -march=rv64gcvxthead" if ARCH_RISCV_VECTOR
	default "-mcmodel=medany -mabi=lp64d -march=rv64gcxthead" if !ARCH_RISCV_VECTOR

config TOOLCHAIN_LD_FLAGS
	string
	default "-melf32lriscv" if ARCH_RISCV_RV32

config TOOLCHAIN_MFPU
	string
	default ""

config TOOLCHAIN_FPU_ABI
	string
	default "-march=rv64gcvxthead" if TOOLCHAIN_FLOAT_SOFT && ARCH_RISCV_VECTOR
	default "-march=rv64gcvxthead" if TOOLCHAIN_FLOAT_SOFTFP && ARCH_RISCV_VECTOR
	default "-march=rv64gcvxthead" if TOOLCHAIN_FLOAT_HARD && ARCH_RISCV_VECTOR
	default "-march=rv64gcxthead" if TOOLCHAIN_FLOAT_SOFT && !ARCH_RISCV_VECTOR
	default "-march=rv64gcxthead" if TOOLCHAIN_FLOAT_SOFTFP && !ARCH_RISCV_VECTOR
	default "-march=rv64gcxthead" if TOOLCHAIN_FLOAT_HARD && !ARCH_RISCV_VECTOR
	default "" if TOOLCHAIN_FLOAT_NONE

config ARCH_RISCV_FPU
	bool "FPU support"
	default y
	---help---
		Build in support for the RISC-V Floating Point Unit (FPU).
		Check your chip specifications first; not all RISC-V chips support the FPU.

config SAVE_C906_FPU_CONTEXT_IN_TCB
	bool "Save C906 FPU context in thread TCB"
	depends on ARCH_RISCV_C906
	depends on ARCH_RISCV_FPU
	default y
	---help---
		When enable this configuration, the system will skip FPU context save/restore
		opertaion on some unnecessary situation, you'd better enable this config unless
		the FPU work abnormally after enable this config.

config RECORD_C906_FPU_CTX_STATISTICS
	bool "Record C906 FPU context save/restore statistics info for debug"
	depends on SAVE_C906_FPU_CONTEXT_IN_TCB
	default n
	---help---
		Record C906 FPU context save/restore operation(skip situation) statistics info.

config ARCH_RISCV_VECTOR
	bool "RISC-V VECTOR support"
	default n
	---help---
		Build in with RVV.
		Check specification first; not all RISC-V chips support the VECTOR.

config SAVE_C906_VECTOR_CONTEXT_IN_TCB
	bool "Save C906 Vecotr context in thread TCB"
	depends on ARCH_RISCV_C906
	depends on ARCH_RISCV_VECTOR
	default y
	---help---
		enable this configuration, save/restore vector context in TCB.

config ARCH_RISCV_PMU
    bool "RISC-V PMU Support"
    default n

config ARCH_HAVE_MMU
    bool "MMU Support"
	default n

config ARCH_HAVE_DCACHE
    bool "DCache Support"
	default n

config ARCH_HAVE_ICACHE
    bool "ICache Support"
	default n

endif
```

## lichee/rtos/components/Kconfig
```kconfig
comment "system components"

menu "aw components"

config COMPONENTS_AW
    bool
    default y

source components/aw/Kconfig
source components/common/aw/Kconfig

endmenu

menu "thirdparty components"

config COMPONENTS_THIRDPARTY
    bool
    default y

source components/thirdparty/Kconfig
source components/common/thirdparty/Kconfig

endmenu
```

## lichee/rtos/components/aw/Kconfig
```kconfig
source components/aw/smartlink/Kconfig

source components/aw/devfs/Kconfig

source components/aw/blkpart/Kconfig

source components/aw/multimedia/Kconfig

source components/aw/secure_storage/Kconfig

source components/aw/bluetooth/Kconfig

source components/aw/watchpoint/Kconfig

source components/aw/ramfs/Kconfig

source components/aw/kasan/Kconfig

source components/aw/memleak/Kconfig

source components/aw/newlibc/Kconfig

source components/aw/ostest/Kconfig

source components/aw/tfm/Kconfig

source components/aw/healthd/Kconfig

source components/aw/camera_preview/Kconfig

source components/aw/wireless_video/Kconfig

source components/aw/pstore/Kconfig
```

## lichee/rtos/components/aw/blkpart/Kconfig
```kconfig
menuconfig COMPONENTS_AW_BLKPART
    bool "Block Partition"
    default y
    help
      Support block partition for block device.

      If unsure, say Y.

if COMPONENTS_AW_BLKPART

    config COMPONENTS_AW_BLKPART_TEST
    bool "Testcase for Block Partition"
    default n
    help
        Enable testcase of block partition for tinatest.
        You can call it by console with:
            tt block [part]:
                do erase/write/read to partition. If no part given, operate the
                last partition.
            tt block <read/write/erase> [part] [addr]:
                operate address base on partition. If no part given, operate
		the last partition. If address given, use 0 default.
            tt block info [part]: show one or all partition

        If unsure, say N.

    config COMPONENTS_AW_BLKPART_PART_TABLE_SIZE
    int "Partition Table Size (KB)"
    default 16
    help
        Size of partition table in KB.

    config COMPONENTS_AW_BLKPART_LOGICAL_OFFSET
    int "Logical Partition Start Address (KB)"
    default 144 if ARCH_SUN20IW2
    default 5120
    help
        The offset address for storage to mapping partition by MBR/GPT.
        It is excluding the size of partition table. For example, the
        GPT table is saved in address (5M - 16K) and the starting address
        for GPT mapping is 5M, in this case, this property should be set
        to 5120(5M).

    config RESERVE_IMAGE_PART
    bool "Reserve Image Part for RTOS"
    default y
    help
        Reserve Image Part for RTOS.

    config RESERVE_FILESYSTEM_PATH
    string "Reserve Image Mount Path"
    default "/reserve"
    depends on RESERVE_IMAGE_PART
    help
        The reserve image of rtosA or rtosB will mount at the path.

    config COMPONENTS_AW_BLKPART_NO_GPT
    bool "hardcode simple gpt when no valid gpt in flash"
    default n
    help
        Hardcode simle gpt when no gpt in flash.
        Only for debug.

endif
```

## lichee/rtos/components/aw/bluetooth/Kconfig
```kconfig
menu "aw bluetooth"

menuconfig AW_COMPONENT_ZBLUE
    bool "zblue"
    default n
    help
      support zblue test.

if AW_COMPONENT_ZBLUE
config AW_BTETF_TOOL
    bool "btetf tool"
	  depends on AW_COMPONENT_ZBLUE
    default y
    help
        If this option is enabled, btetf tool enable.
endif # AW_COMPONENT_ZBLUE

config AW_COMPONENT_RTLBT
    bool "rtlbt"
    default n
    help
      support rtlbt test.

config AW_COMPONENT_ETF
    bool "etf"
    default n
    help
      support etf test.

config AW_COMPONENT_BLUEDROID_OLD
    bool "bluedroid old"
    default n
    help
      support bluedroid_old test.

config AW_COMPONENT_BLUEDROID
    bool "bluedroid"
    default n
    help
      support bluedroid test.

#menuconfig ZEPHYR_BLE
#	bool "Zephyr BLE Host"
#	default n
#	help
#	  This option enables BLE Host support.

config AW_COMPONENT_BLUEDROID_CTRL
    bool "bluedroid ctrl"
    default n
    help
      support bluedroid ctrl test.

config AW_COMPONENT_XBTC_UART
    bool "bluetooth uart"
    default n
    help
      support bluetooth uart control.

#if ZEPHYR_BLE

#source "components/aw/bluetooth/zephyr/Kconfig"

#endif

endmenu
```

## lichee/rtos/components/aw/bluetooth/rtlbt/Kconfig
```kconfig
menu "bluetooth"

config COMPONENTS_BTMANAGER
	select COMPONENTS_RTLBTSTACK
	bool "btmanager"
	default n

endmenu
```

## lichee/rtos/components/aw/camera_preview/Kconfig
```kconfig
menu " Camera Preview to LCD Support"

config COMPONENTS_CAMERA_PREVIEW
    bool "camera preview to lcd support"
    default n
    help
        camera preview to lcd support.

endmenu
```

## lichee/rtos/components/aw/devfs/Kconfig
```kconfig
config COMPONENTS_AW_DEVFS
    bool "Device Filesystem"
    select COMPONENT_VFS
    default y
    help
      Create device file node to VFS. For recommend, devfs mount to /dev.
      It does not support directory, you can only control file on /dev.
      For example, if you want to write to the first partition on nor flash,
      you can execute like:
            fd = open("/dev/nor0p1", O_WRONLY);
            write(fd, buf, count);

      If unsure, say Y.

config COMPONENTS_AW_DEVFS_NULL_DEV
    bool "register /dev/null"
    depends on COMPONENTS_AW_DEVFS
    default y
```

## lichee/rtos/components/aw/healthd/Kconfig
```kconfig
config AW_COMPONENT_HEALTHD
    bool "healthd for axp"
    default n
    depends on DRIVERS_POWER
    help
      support healthd for rtos
```

## lichee/rtos/components/aw/kasan/Kconfig
```kconfig
menu "Kasan Components Support"

config SLAB_DEBUG
    bool "Tina RTOS SLAB DEBUG"
	default n
	depends on RTT_SLAB
	help
        Tina RTOS SLAB DEBUG support

config CHUNK_BACKTRACE_LEVEL
    int "slab debug backtrace level"
	depends on SLAB_DEBUG
	depends on DEBUG_BACKTRACE
	default 16
	help
		"Backtrace level for slab corrupted check"

config KASAN
    bool "Tina RTOS KASAN"
    default n
	depends on SLAB_DEBUG
    help
        Tina RTOS KASAN support.

if KASAN
	config KASAN_SHADOW_OFFSET
	hex "kasan shadow offset"
	default 0x1c000000

	config KASAN_INLINE
	bool "kasan inline"
	default n

	config KASAN_REPEAT_REPORT_ERROR
	bool "kasan repeat report error"
	default y

endif

endmenu
```
