## lichee/dsp/components/aw/testbench/vfpu_test/Kconfig
```kconfig
config VFPU_TEST
	bool "vfpu test (depends hifi5 vfpu library)"
	select COMPONENTS_XTENSA_HIFI5_VFPU_LIBRARY
	default n

if VFPU_TEST
    menu "vfpu test case"
    config VFPU_TEST_CASE1
	    bool "vfpu_test1: test with vec_sigmoidf"
	    default n
    config VFPU_TEST_CASE2
	    bool "vfpu_test2: test with fft_cplxf_ie"
	    default n
    endmenu
endif
```

## lichee/dsp/components/aw/watchpoint/Kconfig
```kconfig
menu "Watchpoint Components Support"

config COMPONENTS_WATCHPOINT
    bool "DSP RTOS Watchpoint"
    default y
    help
        DSP RTOS Watchpoint support.
endmenu
```

## lichee/dsp/components/thirdparty/Kconfig
```kconfig
if PORT_XCC_XTENSA
menu "Xtensa components"

config COMPONENTS_XTENSA
	bool
	default y

source "components/thirdparty/xtensa/Kconfig"

endmenu
endif

if KERNEL_FREERTOS
menu "FreeRTOS components"

config COMPONENTS_FREERTOS
	bool
	default y

source "components/thirdparty/freertos/Kconfig"

endmenu
endif

menu "Algorithm common"
config COMPONENTS_ALGO_COMMON
	bool
	default y
source "components/thirdparty/algo_common/Kconfig"
endmenu

config COMPONENTS_ALGO_SAMPLE
	bool "Algorithm sample"
	default n
	help
	  This is a sample that introduced how to install algorithm.

config COMPONENTS_MSGBOX_DEMO
	bool "Msgbox demo"
	default n
	help
	  This is a demo that introduces how to use msgbox

config COMPONENTS_COREMARK
	bool "Coremark"
	default n
```

## lichee/dsp/components/thirdparty/algo_common/Kconfig
```kconfig
config COMPONENTS_ALGO_GENERATE
	bool "Algorithm generate"
	default n
	depends on COMPONENTS_ALGO_COMMON
	help
	  This is install generate algorithm.
```

## lichee/dsp/components/thirdparty/freertos/FreeRTOS-Plus-CLI/Kconfig
```kconfig
config COMPONENTS_FREERTOS_CLI
	bool "FreeRTOS Plus CLI"
	default n

config COMPONENT_CLI_COMMANDS
	bool "CLI Commands"
	default y

if COMPONENT_CLI_COMMANDS
menu "Supported commands"
source "components/thirdparty/freertos/FreeRTOS-Plus-CLI/commands/Kconfig"
endmenu
endif
```

## lichee/dsp/components/thirdparty/freertos/FreeRTOS-Plus-CLI/commands/Kconfig
```kconfig
config FREERTOS_CLI_CMD_TEMPLATE
	bool "template command (for illustration)"
	default n

config FREERTOS_CLI_CMD_MEM_RW
	bool "Memory read/write"
	default n

config FREERTOS_CLI_CMD_FREE
	bool "Free Memory in Heap"
	default n

config FREERTOS_CLI_CMD_TASK_STATUS
	bool "task status command"
	default n

config FREERTOS_CLI_CMD_FORK
	bool "fork command"
	default n

config FREERTOS_CLI_CMD_TOP
    bool "show task list"
    default n

config FREERTOS_CLI_CMD_TEST_CACHE
    bool "test cache"
    default n
```

## lichee/dsp/components/thirdparty/xtensa/Kconfig
```kconfig
config COMPONENTS_XTENSA_XTOS
	bool "Xtensa XTOS libraries"
	default n
	---help---
		This is the interrupt and vector management package
		that provides startup code, handlers for all the vectors,
		and a simple C interface to interrupts and exceptions.

		If not selected, the compiler will link the default
		libraries from XCC toolchain.

config COMPONENTS_XTENSA_LIBSIM
	bool "Xtensa sim libraries"
	default n
	---help---
		This is used for code running in the Xtensa Instruction
		Set Simulator (ISS) and uses the semi-hosted SIMCALL
		instruction interface to implement a minimal set of
		system calls.

		If not selected, the compiler will link the default
		libraries from XCC toolchain.

config COMPONENTS_XTENSA_LIBGLOSS
	bool "Xtensa GNU Low-Level Operating System Support libraries"
	default n
	---help---
		This is used on board-specific LSPs and requires board-specific
		libraries to implement character I/O and other facilities.

		The routines provided in this library include reentrant stubs and
		wrappers for file and other operations such as _open_r, _close_r,
		_read_r, _write_r, _fstat_r, _stat_r, _lseek_r, _getpid_r, _kill_r,
		and a non-reentrant version of _sbrk_r.

		If not selected, the compiler will link the default
		libraries from XCC toolchain.

config COMPONENTS_XTENSA_HIFI4_VFPU_LIBRARY
	bool "Xtensa HiFi4 NatureDSP Library"
	default n

config COMPONENTS_XTENSA_HIFI5_NNLIB_LIBRARY
	bool "Xtensa HiFi5 nn v_1_7_0 Library"
	default n

config COMPONENTS_XTENSA_HIFI5_VFPU_LIBRARY
	bool "Xtensa HiFi5 vfpu v_2_0_0 Library"
	default n
```

## lichee/dsp/drivers/Kconfig
```kconfig
comment "Configure all required drivers sub-systems"

config DRIVERS_CHIP
	bool "Support rtos-hal drivers"
	default y

config HAL_OSAL
	bool "Support oasl api for rtos-hal drivers"
	select DRIVERS_CHIP
	default y

config DRIVER_SYSCONFIG
	bool "Support parse fex for rtos-hal drivers"
	select DRIVERS_CHIP
	default n

config DRIVER_BOOT_DTS
	bool "Support drivers boot from device tree"
	select DRIVERS_CHIP
	select DRIVER_SYSCONFIG
	select COMPONENTS_OPENAMP_OPEN_AMP
	select COMPONENTS_OPENAMP_VIRTUAL_DRIVER
	default n
	help
		The option need to be selected when booting from dts,
		otherwise not need to select it.

if DRIVERS_CHIP
menu "Supported drivers"
source "drivers/rtos-hal/hal/source/prcm/Kconfig"
source "drivers/rtos-hal/hal/source/ccmu/Kconfig"
source "drivers/rtos-hal/hal/source/uart/Kconfig"
source "drivers/rtos-hal/hal/source/lpuart/Kconfig"
source "drivers/rtos-hal/hal/source/intc/Kconfig"
source "drivers/rtos-hal/hal/source/dma/Kconfig"
source "drivers/rtos-hal/hal/source/gpio/Kconfig"
source "drivers/rtos-hal/hal/source/twi/Kconfig"
source "drivers/rtos-hal/hal/source/spi/Kconfig"
source "drivers/rtos-hal/hal/source/watchdog/Kconfig"
source "drivers/rtos-hal/hal/source/msgbox/Kconfig"
source "drivers/rtos-hal/hal/source/hwspinlock/Kconfig"
source "drivers/rtos-hal/hal/source/timer/Kconfig"
source "drivers/rtos-hal/hal/source/sound/Kconfig"
endmenu
endif
```

## lichee/dsp/kernel/Kconfig
```kconfig
config KERNEL_FREERTOS
	bool "Support FreeRTOS kernel"
	default y

if KERNEL_FREERTOS

choice
	prompt "Kernel version"
	default KERNEL_XTENSA_V1_7

config KERNEL_XTENSA_V1_7
	bool "Use freertos kernel xtensa v1.7"
endchoice

config KERNEL_VERSION_DIR
	string
	default "FreeRTOS_xtensa_v1.7" if KERNEL_XTENSA_V1_7

choice
	prompt "Heap Memory Manager"
	default MEMMANG_HEAP_4

config MEMMANG_HEAP_1
	bool "Use heap_1 to allocate memory"

config MEMMANG_HEAP_2
	bool "Use heap_2 to allocate memory"

config MEMMANG_HEAP_3
	bool "Use heap_3 to allocate memory"

config MEMMANG_HEAP_4
	bool "Use heap_4 to allocate memory"

config MEMMANG_HEAP_5
	bool "Use heap_5 to allocate memory"

config MEMMANG_HEAP_MULTIPLE
	bool "Use heap-multiple to allocate memory"

endchoice

if MEMMANG_HEAP_MULTIPLE
choice
	prompt "Default Heap Ram"
	default DEFAULT_SRAM_HEAP

config DEFAULT_SRAM_HEAP
	bool "default heap in sram"

config DEFAULT_LPSRAM_HEAP
	bool "default heap in lpsram"

config DEFAULT_HPSRAM_HEAP
	bool "default heap in hpsram"

endchoice

config SRAM_HEAP
	bool "sram heap"
	default y

config SRAM_HEAP_DYNAMIC_ADDR
	bool "sram heap dynamic address"
	depends on SRAM_HEAP
	default y

config SRAM_HEAP_START_ADDR
	depends on !SRAM_HEAP_DYNAMIC_ADDR
	depends on SRAM_HEAP
	hex "sram heap start address"
	default 0x4030000

config SRAM_HEAP_SIZE
	depends on SRAM_HEAP
	hex "sram heap size"
	default 0x60000

config LPSRAM_HEAP
	bool "lpsram heap"
	default n

config LPSRAM_HEAP_DYNAMIC_ADDR
	bool "lpsram heap dynamic address"
	depends on LPSRAM_HEAP
	default y

config LPSRAM_HEAP_START_ADDR
	depends on !LPSRAM_HEAP_DYNAMIC_ADDR
	depends on LPSRAM_HEAP
	hex "lpsram heap start address"
	default 0x8030000

config LPSRAM_HEAP_SIZE
	depends on LPSRAM_HEAP
	hex "lpsram heap size"
	default 0x100000

config HPSRAM_HEAP
	bool "hpsram heap"
	default n

config HPSRAM_HEAP_DYNAMIC_ADDR
	bool "hpsram heap dynamic address"
	depends on HPSRAM_HEAP
	default y

config HPSRAM_HEAP_START_ADDR
	depends on !HPSRAM_HEAP_DYNAMIC_ADDR
	depends on HPSRAM_HEAP
	hex "hpsram heap start address"
	default 0xc030000

config HPSRAM_HEAP_SIZE
	depends on HPSRAM_HEAP
	hex "hpsram heap size"
	default 0x100000

endif

choice
	prompt "Portable"
	default PORT_XCC_XTENSA

config PORT_XCC_XTENSA
	bool "XCC/Xtensa"
	---help---
		FreeRTOS Port for Xtensa Configurable Processors
endchoice

config PORT_ARCH_DIR
	string
	default "xtensa" if PORT_XCC_XTENSA
	---help---
		This value must be corresponding to the name of
		the specific arch directory.

config PORT_XEA2
	bool
	default y if PORT_XCC_XTENSA
	---help---
		Xtensa Exception Architecture 2(XEA2) supports.

endif
```

## lichee/rtos-components/aw/AudioSystem/Kconfig
```kconfig
menu "AudioSystem Support"

config COMPONENTS_AW_AUDIO_SYSTEM
	bool "AW Audio System Support"
	depends on COMPONENTS_AW_TINY_ALSA_LIB || AMP_AUDIO_PB_API_ALIAS || AMP_AUDIO_CAP_API_ALIAS
	default n
	help
	  Support Allwinner Audio System component.

config COMPONENTS_AW_AUDIO_SYSTEM_HW
	bool "Audio HW Support"
	depends on COMPONENTS_AW_AUDIO_SYSTEM
	select COMPONENTS_AW_AUDIO_SYSTEM_HW_AMP if AMP_AUDIO_PB_API_ALIAS
	select COMPONENTS_AW_AUDIO_SYSTEM_HW_AMP if AMP_AUDIO_CAP_API_ALIAS
	default n

config COMPONENTS_AW_AUDIO_SYSTEM_HW_PCM
	bool "Audio HW Support PCM"
	depends on COMPONENTS_AW_AUDIO_SYSTEM_HW
	default n

config COMPONENTS_AW_AUDIO_SYSTEM_HW_MULTI_PCM
	bool "Audio HW Support Multi PCM"
	depends on COMPONENTS_AW_AUDIO_SYSTEM_HW_PCM
	default n

config COMPONENTS_AW_AUDIO_SYSTEM_HW_AMP
	bool "Audio HW Support AMP"
	depends on COMPONENTS_AW_AUDIO_SYSTEM_HW
	depends on AMP_AUDIO_PB_API_ALIAS || AMP_AUDIO_CAP_API_ALIAS
	default n

config COMPONENTS_AW_AUDIO_SYSTEM_HW_BT
	bool "Audio HW Support BT"
	depends on COMPONENTS_AW_AUDIO_SYSTEM_HW
	select A2DP_USE_AUDIO_SYSTEM
	select COMPONENTS_RINGBUFFER
	default n

config COMPONENTS_AW_AUDIO_SYSTEM_HW_USB
	bool "Audio HW Support USB"
	depends on COMPONENTS_AW_AUDIO_SYSTEM_HW
	default n

config COMPONENTS_AW_AUDIO_SYSTEM_HW_EQ
	bool "Audio HW Support EQ"
	depends on COMPONENTS_AW_AUDIO_SYSTEM_HW
	depends on SND_COMMON_SUNXI_ALG_CFG
	default n

config COMPONENTS_AW_AUDIO_SYSTEM_HW_AW_EQ
	bool "Audio HW Support AW EQ"
	depends on COMPONENTS_AW_AUDIO_SYSTEM_HW
	depends on COMPONENTS_PROCESS_EQ
	default n

config COMPONENTS_AW_AUDIO_SYSTEM_HW_DRC
	bool "Audio HW Support DRC"
	depends on COMPONENTS_AW_AUDIO_SYSTEM_HW
	depends on SND_COMMON_SUNXI_ALG_CFG
	default n

config COMPONENTS_AW_AUDIO_SYSTEM_TRACK
	bool "Audio Track Support"
	depends on COMPONENTS_AW_AUDIO_SYSTEM_HW
	depends on !AMP_AUDIO_PB_API_UNIQUE
	default n

config COMPONENTS_AW_AUDIO_SYSTEM_RECORD
	bool "Audio Record Support"
	depends on COMPONENTS_AW_AUDIO_SYSTEM_HW
	depends on !AMP_AUDIO_CAP_API_UNIQUE
	default n

config COMPONENTS_AW_AUDIO_SYSTEM_UTILS
	bool "Audio System Utils"
	depends on (AMP_AUDIO_PB_API_UNIQUE && AMP_AUDIO_CAP_API_UNIQUE) || (COMPONENTS_AW_AUDIO_SYSTEM_TRACK && COMPONENTS_AW_AUDIO_SYSTEM_RECORD)
	default n

config COMPONENTS_AW_AUDIO_SYSTEM_UTILS_LOOP
	bool "Audio System loopback utils"
	depends on COMPONENTS_AW_AUDIO_SYSTEM_UTILS
	default n

config COMPONENTS_AW_AUDIO_SYSTEM_UTILS_LOOP_AEC
	bool "loopback utils support aec"
	depends on COMPONENTS_AW_AUDIO_SYSTEM_UTILS_LOOP
	depends on COMPONENTS_PROCESS_AEC
	default n

config COMPONENTS_AW_AUDIO_SYSTEM_PLUGIN
	bool "Audio Plugin Support"
	depends on COMPONENTS_AW_AUDIO_SYSTEM
	depends on COMPONENTS_SPEEXDSP
	default n

config COMPONENTS_AW_AUDIO_SYSTEM_PLUGIN_RESAMPLE_ADJUST
	bool "Audio Plugin resample adjust"
	depends on COMPONENTS_AW_AUDIO_SYSTEM_PLUGIN
	default n

endmenu
```

## lichee/rtos-components/aw/Kconfig
```kconfig
source "components/common/aw/amp/Kconfig"
source "components/common/aw/AudioSystem/Kconfig"
source "components/common/aw/lpvoice/Kconfig"
source "components/common/aw/rpdata/Kconfig"
source "components/common/aw/ringbuffer/Kconfig"
source "components/common/aw/kallsyms/Kconfig"
source "components/common/aw/OpenMax/Kconfig"
source "components/common/aw/test_printf/Kconfig"
source "components/common/aw/rpbuf/Kconfig"
source "components/common/aw/pm/Kconfig"
source "components/common/aw/virt_log/Kconfig"
source "components/common/aw/multi_console/Kconfig"
source "components/common/aw/stackp/Kconfig"
source "components/common/aw/sys_config_script/Kconfig"
source "components/common/aw/iobox/Kconfig"
source "components/common/aw/sysinfo/Kconfig"
source "components/common/aw/console/Kconfig"
source "components/common/aw/usb/Kconfig"
source "components/common/aw/thermal/Kconfig"
source "components/common/aw/pwm_tem/Kconfig"
source "components/common/aw/ota/Kconfig"
source "components/common/aw/ota_v2/Kconfig"
source "components/common/aw/boot_reason/Kconfig"
source "components/common/aw/tinatest/Kconfig"
source "components/common/aw/msgbox_demo/Kconfig"
source "components/common/aw/aactd-lib/Kconfig"
source "components/common/aw/aactd/Kconfig"
source "components/common/aw/network/Kconfig"
source "components/common/aw/wireless/Kconfig"
source "components/common/aw/process_module/Kconfig"
source "components/common/aw/cal_rc_lf/Kconfig"
source "components/common/aw/test_cpufreq/Kconfig"
source "components/common/aw/asr_demo/Kconfig"
```

## lichee/rtos-components/aw/OpenMax/Kconfig
```kconfig
menu "OpenMax Support"

config COMPONENTS_OMX_SYSTEM
	bool "OpenMax Support"
	default n
	help
	  Support Allwinner OMX System component.

config COMPONENTS_OMX_BASE
	bool "OMX base Support"
	depends on COMPONENTS_OMX_SYSTEM
	default n
	help
	  Support Allwinner The Base of OMX System component.
	  
config COMPONENTS_OMX_BASE_FILTER
	bool "OMX base filter Support"
	depends on COMPONENTS_OMX_BASE
	default n
	help
	  Support Allwinner OMX Base filter.

config COMPONENTS_OMX_BASE_SINK
	bool "OMX base sink Support"
	depends on COMPONENTS_OMX_BASE
	default n

config COMPONENTS_OMX_BASE_SOURCE
	bool "OMX base source Support"
	depends on COMPONENTS_OMX_BASE
	default n

config COMPONENTS_OMX_BASE_AUDIO_PORT
	bool "OMX base audio port Support"
	depends on COMPONENTS_OMX_BASE
	default n

config COMPONENTS_OMX_BASE_CLOCK_PORT
	bool "OMX base clock port Support"
	depends on COMPONENTS_OMX_BASE
	default n

config COMPONENTS_OMX_AUDIO_ECHO_CANCEL
	bool "Audio Echo Cancel Component Support"
	depends on COMPONENTS_OMX_BASE_FILTER && COMPONENTS_OMX_BASE_AUDIO_PORT
	default n

config COMPONENTS_OMX_AUDIO_NOISE_SUPPRESS
	bool "Audio Noise Suppression Component Support"
	depends on COMPONENTS_OMX_BASE_FILTER && COMPONENTS_OMX_BASE_AUDIO_PORT
	default n

config COMPONENTS_OMX_AUDIO_EQUALIZER
	bool "Audio Equalizer Component Support"
	depends on COMPONENTS_OMX_BASE_FILTER && COMPONENTS_OMX_BASE_AUDIO_PORT
	default n

config COMPONENTS_OMX_AUDIO_ASR
	bool "Audio Automatic Speech Recognition Component Support"
	depends on COMPONENTS_OMX_BASE_FILTER && COMPONENTS_OMX_BASE_AUDIO_PORT
	default n

config COMPONENTS_OMX_DUMP
	bool "DUMP Component Support"
	depends on COMPONENTS_OMX_BASE_FILTER && COMPONENTS_OMX_BASE_AUDIO_PORT
	default n

config COMPONENTS_OMX_AUDIO_RENDER
	bool "Audio Render Component Support"
	depends on COMPONENTS_OMX_BASE_SOURCE && COMPONENTS_OMX_BASE_AUDIO_PORT
	depends on COMPONENTS_AW_AUDIO_SYSTEM
	default n

config COMPONENTS_OMX_AUDIO_RECORD
	bool "Audio Record Component Support"
	depends on COMPONENTS_OMX_BASE_SINK && COMPONENTS_OMX_BASE_AUDIO_PORT
	depends on COMPONENTS_AW_AUDIO_SYSTEM
	default n

config COMPONENTS_OMX_AUDIO_EFFECT
	bool "Audio Effect Component Support"
	depends on COMPONENTS_OMX_BASE_FILTER && COMPONENTS_OMX_BASE_AUDIO_PORT
	default n

config COMPONENTS_OMX_AUDIO_UTILS
	bool "OMX System Utils"
	#depends on COMPONENTS_OMX_AUDIO_ECHO_CANCEL || COMPONENTS_OMX_AUDIO_NOISE_SUPPRESS
	depends on COMPONENTS_OMX_AUDIO_RECORD || COMPONENTS_OMX_AUDIO_RENDER || COMPONENTS_OMX_AUDIO_ECHO_CANCEL || COMPONENTS_OMX_AUDIO_EQUALIZER || COMPONENTS_OMX_AUDIO_ASR
	default n

endmenu
```

## lichee/rtos-components/aw/aactd-lib/Kconfig
```kconfig
menu "aw aactd lib"

config COMPONENTS_AACTD_LIB
    bool "Audio Calibration Tool Library"
    default n
    help
        "A library for applications that communicate with aactd."

endmenu
```
