## lichee/rtos-components/thirdparty/bluetooth/zephyr/src/net/Kconfig
```kconfig
# Net stack configuration options

# Copyright (c) 2015 Intel Corporation
# SPDX-License-Identifier: Apache-2.0

menu "Networking"

config NET_BUF
	bool "Network buffer support"
	help
	  This option enables support for generic network protocol
	  buffers.

if NET_BUF

config NET_BUF_USER_DATA_SIZE
	int "Size of user_data available in every network buffer"
	default 8 if (BT || NET_TCP2) && 64BIT
	default 4
	range 4 65535 if BT || NET_TCP2
	range 0 65535
	help
	  Amount of memory reserved in each network buffer for user data. In
	  most cases this can be left as the default value.

config NET_BUF_LOG
	bool "Network buffer logging"
	select LOG
	help
	  Enable logs and checks for the generic network buffers.

#module = NET_BUF
#module-str = net_buf
#source "Kconfig.template.log_config"

choice
	prompt "Max compiled-in log level for net_buf"
	default NET_BUF_LOG_LEVEL_INF
	depends on LOG

config NET_BUF_LOG_LEVEL_OFF
	bool "Off"

config NET_BUF_LOG_LEVEL_ERR
	bool "Error"

config NET_BUF_LOG_LEVEL_WRN
	bool "Warning"

config NET_BUF_LOG_LEVEL_INF
	bool "Info"

config NET_BUF_LOG_LEVEL_DBG
	bool "Debug"

endchoice

config NET_BUF_LOG_LEVEL
	int
	depends on LOG
	default 0 if NET_BUF_LOG_LEVEL_OFF
	default 1 if NET_BUF_LOG_LEVEL_ERR
	default 2 if NET_BUF_LOG_LEVEL_WRN
	default 3 if NET_BUF_LOG_LEVEL_INF
	default 4 if NET_BUF_LOG_LEVEL_DBG

if NET_BUF_LOG

config NET_BUF_WARN_ALLOC_INTERVAL
	int "Interval of Network buffer allocation warnings"
	default 1
	range 0 60
	help
	  Interval in seconds of Network buffer allocation warnings which are
	  generated when a buffer cannot immediately be allocated with K_FOREVER
	  which may lead to deadlocks. Setting it to 0 makes warnings to be
	  printed only once per allocation.

config NET_BUF_SIMPLE_LOG
	bool "Network buffer memory debugging"
	select LOG
	help
	  Enable extra debug logs and checks for the generic network buffers.

endif # NET_BUF_LOG

config NET_BUF_POOL_USAGE
	bool "Network buffer pool usage tracking"
	help
	  Enable network buffer pool tracking. This means that:
	  * amount of free buffers in the pool is remembered
	  * total size of the pool is calculated
	  * pool name is stored and can be shown in debugging prints

endif # NET_BUF

#config NETWORKING
#	bool "Link layer and IP networking support"
#	select NET_BUF
#	select POLL
#	select ENTROPY_GENERATOR
#	help
#	  This option enabled generic link layer and IP networking support.

#if NETWORKING

# Such option should not be configured manually but by device drivers
# which supports PM properly.
#config NET_POWER_MANAGEMENT
#	bool
#	default n
#	depends on DEVICE_POWER_MANAGEMENT

#source "subsys/net/Kconfig.hostname"

#source "subsys/net/l2/Kconfig"

#source "subsys/net/ip/Kconfig"

#source "subsys/net/lib/Kconfig"

#endif

endmenu
```

## lichee/rtos-components/thirdparty/cjson/Kconfig
```kconfig
menu "cjson parser"

config COMPONENT_CJSON
    bool "cjson support"
    default n

endmenu
```

## lichee/rtos-components/thirdparty/env/Kconfig
```kconfig
menuconfig COMPONENT_ENV
    bool "uboot env"
    select COMPONENTS_AW_BLKPART
    default n
    help
      support read write uboot env
      If unsure, say Y.

if COMPONENT_ENV

    config COMPONENTS_ENV_SIZE
    int "Env Size (bytes)"
    default 4096
    help
        Size of env in bytes.

    config COMPONENTS_ENV_PRINTENV
    bool "print env"
    default y
    help
        print env.

    config COMPONENTS_ENV_SETENV
    bool "set env"
    default y
    help
        set env.

    config COMPONENTS_ENV_FILE_SUPPORT
    bool "support file operations"
    default y
    help
        support standard open,read,write.

endif
```

## lichee/rtos-components/thirdparty/giflib/Kconfig
```kconfig
menuconfig COMPONENTS_GIFLIB
	bool "giflib"
	default n

if COMPONENTS_GIFLIB

config GIFLIB_TEST_DEMO
	bool "giflib test demo"
	default n
		help
		giflib test demo

endif
```

## lichee/rtos-components/thirdparty/libjpeg-turbo/Kconfig
```kconfig
menuconfig COMPONENTS_LIBJPEG_TURBO
	bool "libjpeg-turbo"
	default n

if COMPONENTS_LIBJPEG_TURBO

config LIBJPEG_CJPEG
	bool "libjpeg code command cjpeg"
 	default n
		help
		support cjpeg command

config LIBJPEG_DJPEG
	bool "libjpeg decode command djpeg"
	default n
		help
		support djepg command

config LIBJPEG_TEST_DEMO
	bool "libjpeg test demo jpeg_test"
	default n
		help
		libjpeg-turbo test demo - jpeg_test

endif
```

## lichee/rtos-components/thirdparty/littlevgl-8/Kconfig
```kconfig
menuconfig COMPONENTS_LVGL8
	bool "Littlevgl-8"
	default n

if COMPONENTS_LVGL8

config LVGL8_EXAMPLES
	bool "lvgl examples"
	default y
		help
		lvgl examples use lvgl-8.1.0

config LVGL8_G2D_TEST
	bool "lvgl g2d test"
	default n
		help
		lvgl g2d test use lvgl-8.1.0

config LVGL8_USE_SUNXIFB_DOUBLE_BUFFER
	bool "lvgl-8.1.0 use sunxifb double buffer"
	default y
		help
		Whether use sunxifb double buffer
config LVGL8_USE_SUNXIFB_CACHE
		bool "lvgl-8.1.0 use sunxifb cache"
	default y
		help
		Whether use sunxifb cache
config LVGL8_USE_SUNXIFB_G2D
	bool "lvgl-8.1.0 use sunxifb g2d"
	select LVGL8_USE_SUNXIFB_DOUBLE_BUFFER
	select DRIVERS_G2D
	default n
		help
		Whether use sunxifb g2d
config LVGL8_USE_SUNXIFB_G2D_ROTATE
	bool "lvgl-8.1.0 use sunxifb g2d rotate"
	select LVGL8_USE_SUNXIFB_G2D
	default n
		help
		Whether use sunxifb g2d rotate
config LVGL8_USE_FREETYPE
	bool "lvgl-8.1.0 use freetype"
	select COMPONENT_FREETYPE
	default n
		help
		Whether use freetype


endif
```

## lichee/rtos-components/thirdparty/littlevgl-8/lv_examples/Config.in
```kconfig
config LVGL8_USE_SUNXIFB_DOUBLE_BUFFER
	bool "lvgl-8.1.0 use sunxifb double buffer"
	default y
		help
		Whether use sunxifb double buffer
config LVGL8_USE_SUNXIFB_CACHE
		bool "lvgl-8.1.0 use sunxifb cache"
	select LVGL8_USE_SUNXIFB_DOUBLE_BUFFER
	default y
		help
		Whether use sunxifb cache
config LVGL8_USE_SUNXIFB_G2D
	bool "lvgl-8.1.0 use sunxifb g2d"
	select LVGL8_USE_SUNXIFB_DOUBLE_BUFFER
	default n
		help
		Whether use sunxifb g2d
config LVGL8_USE_SUNXIFB_G2D_ROTATE
	bool "lvgl-8.1.0 use sunxifb g2d rotate"
	select LVGL8_USE_SUNXIFB_G2D
	default n
		help
		Whether use sunxifb g2d rotate
config LVGL8_USE_FREETYPE
	bool "lvgl-8.1.0 use freetype"
	default n
		help
		Whether use freetype
```

## lichee/rtos-components/thirdparty/network/Kconfig
```kconfig
menu "network"

menuconfig COMPONENTS_LWIP
	bool "lwip"
	default n
	if COMPONENTS_LWIP
		choice
			default COMPONENTS_LWIP_2_1_2 if ARCH_SUN20IW2P1
			default COMPONENTS_LWIP_2_0_3
			prompt "lwip version"
			help
			the TCP/IP protocol suite
		config COMPONENTS_LWIP_2_0_3
			bool "lwip-2.0.3"
		config COMPONENTS_LWIP_2_1_2
			bool "lwip-2.1.2"
		endchoice
	endif

config COMPONENTS_UDHCPD
	bool "udhcpd (DHCP Server)"
	default n

config COMPONENTS_PING
	bool "ping"
	default n

menuconfig COMPONENTS_MBEDTLS
	bool "mbedtls"
	default n
	if COMPONENTS_MBEDTLS
		choice
			default COMPONENTS_MBEDTLS_2_16_0 if ARCH_SUN20IW2P1
			default COMPONENTS_MBEDTLS_2_7_0
			prompt "mbedtls version"
		config COMPONENTS_MBEDTLS_2_7_0
			bool "mbedtls-2.7.0"
		config COMPONENTS_MBEDTLS_2_16_0
			bool "mbedtls-2.16.0"
		endchoice
		if !ARCH_SUN20IW2P1
			config COMPONENTS_MBEDTLS_TEST
				bool "mebdtls test"
				default n
		endif
	endif

config COMPONENTS_HTTPCLIENT
	bool "httpclient"
	select COMPONENTS_MBEDTLS
	select COMPONENTS_MBEDTLS_2_16_0
	default n

config COMPONENTS_WEBSOCKET
	bool "websocket"
	default n

config COMPONENTS_NGHTTP2
	bool "nghttp2"
	default n

config COMPONENTS_SNTP
	bool "sntp"
	default n

config COMPONENTS_NOPOLL
	bool "nopoll"
	default n

config COMPONENTS_SHTTPD
	bool "shttpd"
	default n

config COMPONENTS_MQTT
	bool "mqtt"
	default n

endmenu
```

## lichee/rtos-components/thirdparty/opus/Kconfig
```kconfig
menuconfig COMPONENTS_OPUS
    bool "opus audio codec"
    default n
    help
      support Opus audio codec

if COMPONENTS_OPUS

    config COMPONENTS_OPUS_TEST
    bool "OPUS Test Suite"
    default n
    help
      A collection of OPUS automated unit and system tests.

endif
```

## lichee/rtos-components/thirdparty/speexdsp/Kconfig
```kconfig
config COMPONENTS_SPEEXDSP
    bool "speexdsp"
    default n
    help
      support speexdsp resample
```

## lichee/rtos-components/thirdparty/tinycrypt/Kconfig
```kconfig
config COMPONENT_TINYCRYPT
    bool "tinycrypt"
    default n
    help
      support tinycrypt
```

## lichee/rtos-components/thirdparty/unity/Kconfig
```kconfig
menu "unity test framework"

config COMPONENT_UNITY
    bool "unity test framework"
    default n

endmenu
```

## lichee/rtos-hal/hal/source/cir_tx/Kconfig
```kconfig
menu "CIR_TX Devices"

config DRIVERS_CIR_TX
	bool "enable CIR_TX driver"
        default n

menu "CIR_TX option features"

config DRIVERS_CIR_TX_DEBUG
	bool "support CIR_TX debug"
	select DRIVERS_CIR
	default n

config HAL_TEST_CIR_TX
	bool "CIR_TX TEST CASE"
	depends on DRIVERS_CIR_TX
	default n

endmenu

endmenu
```

## lichee/rtos-hal/hal/source/csi/Kconfig
```kconfig
menu "CSI Devices"

config DRIVERS_CSI
    bool "enable csi driver"
        default n

config CSI_CAMERA
    bool "enable csi camera driver"
          depends on DRIVERS_CSI
	default y

menuconfig CSI_CAMERA_CHOICE
    bool "csi camera choice"
	  depends on DRIVERS_CSI
          select DRIVERS_TWI
    default y
    help
      select csi camera.

if CSI_CAMERA_CHOICE

config CSI_CAMERA_GC0308
    bool "csi camera GC0308"
	  depends on CSI_CAMERA_CHOICE
    default y
    help
        support csi camera gc0308.

config CSI_CAMERA_GC2145
    bool "csi camera GC2145"
	  depends on CSI_CAMERA_CHOICE
    default n
    help
        support csi camera gc2145.

config CSI_CAMERA_GC0328c
    bool "csi camera GC0328c"
	  depends on CSI_CAMERA_CHOICE
    default n
    help
        support csi camera gc0328c.

config CSI_CAMERA_OV7670
    bool "csi camera ov7670"
	  depends on CSI_CAMERA_CHOICE
    default n
    help
        support csi camera ov7670.

endif

config JPEG_ENCODER
    bool "enable jpeg encoder"
    depends on DRIVERS_CSI
          select DRIVERS_SYSCTL
    default y
    help
       support jpeg encoder

config HAL_TEST_CSI
    bool "enable csi demo test command"
	depends on DRIVERS_CSI
        default n

endmenu
```

## lichee/rtos-hal/hal/source/efuse/Kconfig
```kconfig
menu "EFUSE Devices"

config DRIVERS_EFUSE
    bool "enable efuse driver"
        default n

config HAL_TEST_EFUSE
    bool "enable efuse hal APIs test command"
	depends on DRIVERS_EFUSE
        default n

endmenu
```

## lichee/rtos-hal/hal/source/flashc/Kconfig
```kconfig
menu "FlashControler Devices"

config DRIVERS_FLASHC
    bool "enable flashc driver"
        default y

if DRIVERS_FLASHC
config HAL_TEST_FLASHC
    bool "enable flash hal APIs test command"
    depends on DRIVERS_FLASHC
        default n

config HAL_TEST_FLASHC_ENC
    bool "enable flash enc hal APIs test command"
    depends on FLASHC_ENC
        default n

config CHIP_ARCH_VER
    int "select chip arch version for flashc"
	default 3

config XIP
    bool "enable flashc xip"
    depends on DRIVERS_FLASHC
		select COMPONENTS_AW_BLKPART
    default y

config SECTION_ATTRIBUTE_XIP
    bool "support xip_text section"
    depends on XIP
    default y

config SECTION_ATTRIBUTE_NONXIP
    bool "support nonxip_text section"
    depends on XIP
    default y

config SECTION_ATTRIBUTE_SRAM
    bool "support sram_text section"
    depends on XIP
    default y

config FLASHC_GET_XIP_PARTITION_FROM_ENV
    bool "support get xip partition form env"
    depends on XIP
    default y

config FLASHC_CPU_XFER_ONLY
    bool "disable flashc dma"
    depends on DRIVERS_FLASHC
    default y

config FLASHC_ENC
    bool "enable flashc enc"
    depends on DRIVERS_FLASHC
    default n

config HAL_TEST_FLASH_CTRL
    bool "enable flashc test command"
    depends on DRIVERS_FLASHC
    default n

config FLASH_POWER_DOWN_PROTECT
    bool "enable flash power down write protect"
    depends on DRIVERS_FLASHC
    default n
    help
      Some nor flash support write protection. This feature is much usefull
      for power lose case to avoid data corruption. Most of them support zone
      protection, which cost much for status register and to protect
      a continuous space from head or tail. That's NOT what we need. What this
      option used, is individual block protection. Before we do write/erase
      operation, we unlock (unprotect) the individual block we want and still
      protect other blocks. As you see, the unit to lock/unlock is a block.
      Beside, it just rewrite a volatile memory, not status register, which
      has less time and wear costs.

      In a word, It spends very little time to protect data if power lose.

      If unsure, please says N.

config FLASH_LOW_POWER_PROTECT
    bool "enable flash low power write protect"
    depends on FLASH_POWER_DOWN_PROTECT
    select DRIVERS_POWER_PROTECT
    default n

config DRIVERS_SPINOR_PANIC_WRITE
    bool "Support write or read spinor data if crash"
    depends on DRIVERS_FLASHC
    select DRIVERS_FLASHC_PANIC_TRANSFER
    default n

config DRIVERS_FLASHC_PANIC_TRANSFER
    bool "support sp transfer if crash"
    depends on DRIVERS_FLASHC
        default n

endif
endmenu
```

## lichee/rtos-hal/hal/source/gpadc/Kconfig
```kconfig
menu "GPADC Devices"

config DRIVERS_GPADC
    bool "enable gpadc driver"
        default y

config DRIVERS_POWER_PROTECT
    bool "enable power protect driver"
    depends on DRIVERS_GPADC
        default n

config HAL_TEST_GPADC
    bool "enable gpadc hal APIs test command"
    depends on DRIVERS_GPADC
        default n

endmenu
```
