## lichee/rtos-components/aw/multi_console/Kconfig
```kconfig
menu "Multi Console Support"

config MULTI_CONSOLE
	bool "Multi Console Support"
	default n
	help
	  Support AW Multi Console component.

config MULTI_CONSOLE_DEBUG
	bool "Multi Console Debug Mode"
	default n
	depends on MULTI_CONSOLE
	help
	  Enable AW Multi Console Debug.

config UART_MULTI_CONSOLE
	bool "Uart Multi Console Support"
	default n
	depends on DRIVERS_UART
	help
	  Support AW Uart Multi Console component.

config UART_MULTI_CONSOLE_AS_MAIN
	bool "Uart Multi Console As Main Console"
	default n
	depends on UART_MULTI_CONSOLE
	help
	  Support AW Uart Multi Console component.

config RPMSG_MULTI_CONSOLE
	bool "Rpmsg Multi Console Support"
	default n
	depends on RPMSG_CLIENT
	help
	  Support AW RPMSG Multi Console component.

config RPMSG_CONSOLE_CACHE
	bool "Rpmsg Multi Console Enable Cache Cmd"
	default n
	depends on RPMSG_MULTI_CONSOLE
	help
	  Rpmsg Multi Console Enable Cache Cmd.

endmenu
```

## lichee/rtos-components/aw/network/Kconfig
```kconfig
menu "aw network"
config COMPONENTS_TCPIP
	bool "tcp ip adapter"
	select DRIVERS_RFKILL
	default n

config COMPONENTS_LOOPIF_TEST
	bool "loop interface test demo"
	default n

config COMPONENTS_WIFI
	bool "wifi test demo"
	default n

config COMPONENTS_WLAN_CSFC
	bool "wifi fast connect test demo"
	default n
	select DRIVERS_TRNG
	depends on COMPONENTS_WIFIMANAGER

config COMPONENTS_WLAN_MAC
	bool "get mac_addr test demo"
	default n
	select DRIVERS_TRNG
	select DRIVERS_EFUSE
	depends on COMPONENTS_WIFIMANAGER

config COMPONENTS_WLAN_COUNTRY_CODE
	bool "set/get country code optional"
	default n
	select DRIVERS_TRNG
	depends on COMPONENTS_WIFIMANAGER

source components/common/aw/network/service/Kconfig
endmenu
```

## lichee/rtos-components/aw/network/service/Kconfig
```kconfig
menu "service"
config COMPONENTS_SERVICE_UDHCPD
	bool "udhcpd demo"
	select COMPONENTS_UDHCPD
	default n
	help
		this is udhcpd command example

config COMPONENTS_SERVICE_SNTP
	bool "sntp demo"
	select COMPONENTS_SNTP
	default n
	help
		this is sntp command example

config COMPONENTS_SERVICE_IPERF
	bool "iperf demo"
	default n
	select NEWLIBC_NANO_SCANF_FLOAT
	help
		this is iperf command example

config COMPONENTS_SERVICE_PING
	bool "ping demo"
	depends on COMPONENTS_PING
	default n
	help
		this is ping command example

config COMPONENTS_SERVICE_NOPOLL
	bool "nopoll demo"
	select COMPONENTS_NOPOLL
	default n
	help
		this is nopoll command example

config COMPONENTS_SERVICE_MQTT
	bool "mqtt demo"
	select COMPONENTS_MQTT
	default n
	help
		this is mqtt command example

config COMPONENTS_SERVICE_SHTTPD
	bool "shttpd demo"
	select COMPONENTS_SHTTPD
	default n
	help
		this is shttpd command example

if COMPONENTS_MBEDTLS_2_16_0
config COMPONENTS_SERVICE_MBEDTLS
	bool "mbedtls demo"
	default n
	help
		this is mbedtls command example
endif

config COMPONENTS_SERVICE_HTTPCLIENT
	bool "httpc demo"
	select COMPONENTS_HTTPCLIENT
	default n
	help
		this is httpclient command example

config COMPONENTS_SERVICE_MINI_WGET
	bool "mini_wget"
	default n
	help
		this is wget command example

config COMPONENTS_SERVICE_TELNET
	bool "telnet"
	default n
	help
		this is telnet command example

endmenu
```

## lichee/rtos-components/aw/ota/Kconfig
```kconfig
menu "AW OTA Compenents"

config COMPONENTS_AW_UPGRADE_APP
    bool "Tina RTOS OTA UPGRADE_APP"
    default n
    help
        Tina RTOS OTA upgrade_app support.
        If unsure, say N.


if COMPONENTS_AW_UPGRADE_APP

config COMPONENTS_AW_UPGRADE_MD5SUM
	bool "Tina RTOS OTA MD5SUM"
	select COMPONENTS_MD5
	default y
	help
		Tina RTOS OTA md5sum after ota finished.
		If unsure, say N.

endif
endmenu
```

## lichee/rtos-components/aw/ota_v2/Kconfig
```kconfig
menu "AW OTA Compenents version 2"

config COMPONENTS_AW_OTA_V2
    bool "Tina RTOS OTA APP VERSION 2"
    select COMPONENT_ENV
    default n
    help
        Tina RTOS OTA support version 2.
        If unsure, say N.

config COMPONENTS_AW_OTA_V2_NETWORK
    bool "Tina RTOS OTA APP VERSION 2 FOR NETWORK"
    depends on COMPONENTS_AW_OTA_V2
	select COMPONENTS_HTTPCLIENT
	default n
    help
        Tina RTOS OTA version 2 for network.
        If unsure, say N.

config COMPONENTS_AW_OTA_V2_RECOVERY
    bool "Tina RTOS OTA APP VERSION 2 Recovery"
    default n
    help
        Tina RTOS OTA support version 2.
        If unsure, say N.


#if COMPONENTS_AW_OTA_V2
#
#config COMPONENTS_AW_UPGRADE_MD5SUM
#	bool "Tina RTOS OTA MD5SUM"
#	select COMPONENTS_MD5
#	default y
#	help
#		Tina RTOS OTA md5sum after ota finished.
#		If unsure, say N.
#
#endif
endmenu
```

## lichee/rtos-components/aw/pm/Kconfig
```kconfig
menuconfig COMPONENTS_PM
    bool "PowerManager Support"
    default n
    help
      Support standby and hibernation mode.

if COMPONENTS_PM
choice COMPONENTS_PM_CORE
    prompt "Select core"
    default COMPONENTS_PM_CORE_M33   if ARCH_ARM_ARMV8M
    default COMPONENTS_PM_CORE_RISCV if ARCH_RISCV_RV64
    default COMPONENTS_PM_CORE_DSP   if ARCH_DSP
    help
      This option determines which core the PM run on.

    config COMPONENTS_PM_CORE_M33
        bool "M33"
        help
          the code for m33

    config COMPONENTS_PM_CORE_DSP
        bool "DSP"
        help
          the code for dsp

    config COMPONENTS_PM_CORE_RISCV
        bool "RISCV"
        help
          the code for riscv
endchoice

menuconfig COMPONENTS_PM_WAKESRC
    bool "List of wakeup source types"
    default y
    help
	List of wakesrc on the core.
	Some wakeup sources may need to register with the specific core.
	It is only used to detemine whether it is a wakeup source for the the driver that needs it.
	Configuration is n does not mean the wakesrc is not supported.

if COMPONENTS_PM_WAKESRC
config PM_WAKESRC_WUPIO
    bool "WUPIO wakesrc"
    default y
    help
      WUPIO wakesrc

config PM_WAKESRC_WUPTIMER
    bool "WUPTIMER wakesrc"
    default y
    help
      WUPTIMER wakesrc

config PM_WAKESRC_ALARM
    bool "RTC  Alarm wakesrc"
    default y
    help
      RTC alarm wakesrc

config PM_WAKESRC_LPUART
    bool "LPUART wakesrc"
    default n
    help
      LPUART wakesrc

config PM_WAKESRC_GPADC
    bool "GPADC wakesrc"
    default n
    help
      GPADC wakesrc

config PM_WAKESRC_MAD
    bool "MAD wakesrc"
    default n
    help
      MAD wakesrc

config PM_WAKESRC_WLAN
    bool "WLAN wakesrc"
    default n
    help
       WLAN wakesrc

config PM_WAKESRC_BLE
    bool "BLE wakesrc"
    default n
    help
       BLE wakesrc

config PM_WAKESRC_GPIO
    bool "GPIO wakesrc"
    default n
    help
       GPIO wakesrc
endif

comment "Special Config"
config ARCH_PM_FIRMWARE_BASE
    hex "PM Firmware's space base"
    default 0x04000000
    depends on COMPONENTS_PM_CORE_M33
    help
      The space must be placed on SRAM.
      This parameter takes effect only after
      COMPONENTS_PM_CORE_M33 is enabled

config ARCH_PM_FIRMWARE_SIZE
    hex "PM Firmware's space size"
    default 0x10000
    depends on COMPONENTS_PM_CORE_M33
    help
      The recommended value is not less than 64K.

config PM_SIMULATED_RUNNING
    bool "Simulated on FPGA"
    default n
    help
      Simulates a running environment on the FPGA

config PM_SUBSYS_RISCV_SUPPORT
    bool "support riscv subsys"
    default y
    depends on COMPONENTS_PM_CORE_M33
    help
      Enable riscv subsys support

config PM_SUBSYS_DSP_SUPPORT
    bool "support dsp subsys"
    default n
    depends on COMPONENTS_PM_CORE_M33
    help
      Enable dsp subsys support

config COMPONENTS_PM_TEST_TOOLS
    bool "PM test tools"
    default n
    depends on COMPONENTS_PM
    help
      Enable pm test tools, including pm stress, recording sign and etc.

endif
```

## lichee/rtos-components/aw/process_module/Kconfig
```kconfig
menu "Algorithm Process Module"

config COMPONENTS_PROCESS_AEC
         bool "AEC Module"
         default n
         help
           This is a AEC process module.

config COMPONENTS_PROCESS_EQ
         bool "EQ Module"
         default n
         help
           This is a EQ process module.

endmenu
```

## lichee/rtos-components/aw/pwm_tem/Kconfig
```kconfig
config COMPONENT_PWM_TEM
	bool "PWM_TEM Support"
	default n
	help
		support component aw pwm_tem management.
	depends on DRIVERS_PWM
	depends on COMPONENT_THERMAL
```

## lichee/rtos-components/aw/ringbuffer/Kconfig
```kconfig
config COMPONENTS_RINGBUFFER
	bool "AW Ringbuffer Support"
	default y
	help
	  Support Allwinner Ringbuffer.
```

## lichee/rtos-components/aw/rpbuf/Kconfig
```kconfig
menu "RPBuf framework"

config COMPONENTS_RPBUF
	bool
	help
	  The RPBuf (Remote Processor Buffer) framework provides mechanisms to
	  allocate buffers and transmit their references to remote processor.
	  This allows user to exchange large data with remote processor.

menuconfig COMPONENTS_RPBUF_MEASURE_TIME
	bool "Rpbuf measure transmit time"
	default n
	select COMPONENTS_RPBUF
	help
	  It will take up part of buffer record sending time

if COMPONENTS_RPBUF_MEASURE_TIME
config COMPONENTS_RPBUF_MEASURE_TIMER_BASE
	hex "measurement timer regiser base address"
	default 0
config COMPONENTS_RPBUF_DUMP_TIME_INFO
	bool "dump buf transmit time"
	default n
endif # COMPONENTS_RPBUF_MEASURE_TIME

config COMPONENTS_RPBUF_SERVICE_RPMSG
	bool "RPMsg-based RPBuf service component"
	select COMPONENTS_RPBUF
	select COMPONENTS_OPENAMP_OPEN_AMP
	default n
	help
	  Say y here to enable support for the RPMsg-based RPBuf service component.
	  This is one kind of RPBuf service backend implemented with RPMsg.

config COMPONENTS_RPBUF_CONTROLLER
	bool "RPBuf controller component"
	select COMPONENTS_RPBUF
	default n
	help
	  Say y here to enable support for the RPBuf controller component.

config COMPONENTS_RPBUF_DEMO
	bool "RPBuf Demo"
	select COMPONENTS_RPBUF
	default n

endmenu
```

## lichee/rtos-components/aw/rpdata/Kconfig
```kconfig
menu "RPData Components Support"

config COMPONENTS_RPDATA
	bool "AW RPData Support"
	depends on COMPONENTS_AMP
	select AMP_RPDATA_STUB
	select AMP_RPDATA_SERVICE
	default n
	help
	  Support Allwinner Remote Processor Data, allocate buffers and transmit/receive
	  their references to/from remote processor.

config COMPONENTS_RPDATA_DEMO
	bool "AW RPData Demo"
	depends on COMPONENTS_RPDATA
	default n
	select COMPONENTS_MD5
	help
	  Support RPData demo, test api

config COMPONENTS_RPDATA_AUDIO_DEMO
	bool "AW RPData Audio Demo"
	depends on COMPONENTS_RPDATA
	depends on COMPONENTS_AW_AUDIO_SYSTEM_RECORD
	default n
	help
	  Support RPData Audio demo, record and data transmit

endmenu
```

## lichee/rtos-components/aw/stackp/Kconfig
```kconfig
menu "StackProtector Components Support"

config COMPONENTS_STACK_PROTECTOR
    bool "Tina RTOS Stack Protector"
    default n
    help
        Tina RTOS Stack Protector support.
endmenu
```

## lichee/rtos-components/aw/sys_config_script/Kconfig
```kconfig
menuconfig COMPONENTS_AW_SYS_CONFIG_SCRIPT
	bool "sys_config support"
	default n
	help
		Enable r128 sys_config interface support

if COMPONENTS_AW_SYS_CONFIG_SCRIPT

choice
	prompt "choice build type"
	default SYS_CONFIG_PACK

	config SYS_CONFIG_BUILDIN
		bool "compile in img"
		help
			if enable this option, sys_config.bin will build in output file

	config SYS_CONFIG_PACK
		bool "pack in fixed address"
		help
			if enable sys_config.bin will be loaded in fixed address
endchoice

if SYS_CONFIG_PACK
	config SYS_CONFIG_PACK_ADDRESS
		default 0x8000000
		hex "sysconfig pack in fixed address"

endif

endif
```

## lichee/rtos-components/aw/sysinfo/Kconfig
```kconfig
menu "sysinfo Support"

config COMPONENTS_SYSINFO
    bool "sysinfo support"
    default n
    help
        sysinfo support.

endmenu
```

## lichee/rtos-components/aw/test_cpufreq/Kconfig
```kconfig
if ARCH_SUN20IW2

menu "Test cpufreq Component Support"

config COMPONENTS_TEST_CPUFREQ
    bool "cpufreq API test commands"
    default n

endmenu

endif
```

## lichee/rtos-components/aw/test_printf/Kconfig
```kconfig
menu "Test printf Components Support"

config COMPONENTS_TEST_PRINTF
    bool "printf API test with some possible race condition"
    default n

endmenu
```

## lichee/rtos-components/aw/thermal/Kconfig
```kconfig
config COMPONENT_THERMAL
	bool "Thermal Support"
	default n
	select DRIVERS_EFUSE
	help
		support component aw thermal management.
		Each thermal zone contains its own temperature.
```

## lichee/rtos-components/aw/tinatest/Kconfig
```kconfig
menuconfig COMPONENTS_AW_TINATEST
    bool "TinaTest Test Platform"
    select COMPONENT_CLI
    default n
    help
        TinaTest, which is test platform for Tina SDK. You can call it on
        console by enter "tt".

        The command "tt -p" will print all testcase enabled. You can call
        testcase by "tt <testcase name>". You can also call all of testcases
        without any arguments by "tt", in this case, tt will exit once
        testcase return not equal to 0.

        If unsure, say N.

if COMPONENTS_AW_TINATEST
config DRAGONMAT
	bool "Dragonmat"
	default n

menu "TESTCASE"

source components/common/aw/tinatest/testcase/Kconfig
endmenu

endif
```

## lichee/rtos-components/aw/tinatest/testcase/Kconfig
```kconfig
source components/common/aw/tinatest/testcase/demo/Kconfig
source components/common/aw/tinatest/testcase/led/Kconfig
source components/common/aw/tinatest/testcase/key/Kconfig
source components/common/aw/tinatest/testcase/wifi/Kconfig
source components/common/aw/tinatest/testcase/audio/Kconfig
source components/common/aw/tinatest/testcase/rtc/Kconfig
source components/common/aw/tinatest/testcase/bt/Kconfig
source components/common/aw/tinatest/testcase/uart/Kconfig
source components/common/aw/tinatest/testcase/reboot/Kconfig
source components/common/aw/tinatest/testcase/storage/Kconfig
source components/common/aw/tinatest/testcase/ddr/Kconfig
source components/common/aw/tinatest/testcase/lpsram/Kconfig
source components/common/aw/tinatest/testcase/tp/Kconfig
source components/common/aw/tinatest/testcase/rw-throughput/Kconfig
source components/common/aw/tinatest/testcase/camera/Kconfig
source components/common/aw/tinatest/testcase/g2d/Kconfig
source components/common/aw/tinatest/testcase/display/Kconfig
```

## lichee/rtos-components/aw/tinatest/testcase/audio/Kconfig
```kconfig
menu "Audio Testcase"
	depends on COMPONENTS_AW_ALSA_LIB || COMPONENTS_AW_AUDIO_SYSTEM
	depends on COMPONENTS_AW_ALSA_UTILS || COMPONENTS_AW_AUDIO_SYSTEM_UTILS

config TESTCASE_AUDIO_MIC_CAPTURE
	bool "Audio MIC capture testcase."
	default n

config TESTCASE_AUDIO_SPEAKER_PLAYBACK
	bool "Audio speaker playback testcase."
	default n

config TESTCASE_AUDIO_PLAYBACK_AND_CAPTURE
	bool "Audio playback and then capture testcase."
	default n

config TESTCASE_AUDIO_PLAYBACK_OPEN_CLOSE
	bool "Audio open close playback soundcard testcase."
	default n

endmenu
```

## lichee/rtos-components/aw/tinatest/testcase/bt/Kconfig
```kconfig
menu "Bluetooth Testcase"
	depends on COMPONENTS_BTMANAGER

config TESTCASE_BTON
	bool "BT On Testcase."
	default n

config TESTCASE_BTOFF
	default n
	bool "BT Off Testcase."

config TESTCASE_BTSCAN
	default n
	bool "BT Scan Testcase."

endmenu
```

## lichee/rtos-components/aw/tinatest/testcase/display/Kconfig
```kconfig
menu "Display Testcase"

config TESTCASE_LVGL
	bool "LVGL Testcase."
	default n

config TESTCASE_DISPLAYIF
	bool "DISPLAYIF Testcase."
	depends on DISP2_SUNXI
	default n

endmenu
```
