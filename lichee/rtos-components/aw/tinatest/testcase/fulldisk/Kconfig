## lichee/rtos-components/aw/tinatest/testcase/fulldisk/Kconfig
```kconfig
config TESTCASE_FULLDISK
	bool "FullDisk Testcase."
	depends on DRIVERS_SPINOR
	default n
```

## lichee/rtos-components/aw/tinatest/testcase/led/Kconfig
```kconfig
config TESTCASE_LEDC
	bool "LEDC Testcase."
	depends on DRIVERS_LEDS_SUNXI
	default n

config TESTCASE_PWMLED
	bool "PWM LED Testcase."
	depends on DRIVERS_PWM_LEDS
	default n
```

## lichee/rtos-components/aw/tinatest/testcase/lpsram/Kconfig
```kconfig
menuconfig TESTCASE_LPSRAM
	bool "LPSRAM Testcase."
	#depends on DRIVERS_LPSRAM
	default n

if TESTCASE_LPSRAM
config LPSRAM_DATA_LEN
	default 512k
	string "data len"
	help
		This means how many data will be tested by dma.Please input "512k/1024k/.etc"
config LPSRAM_TIMES
	default 10
	string "test times"
	help
		This means how many times to test lpsram
config LPSRAM_STRESS
	default 0
	string "stress test"
	help
		This means whether run stress test. 0:not set, 1:stress.
endif
```

## lichee/rtos-components/aw/tinatest/testcase/reboot/Kconfig
```kconfig
menuconfig TESTCASE_REBOOT
	bool "Reboot Testcase."

	default n

if TESTCASE_REBOOT
config REBOOT_TIMES
	default "10000"
	string "reboot times"
	help
		This means how many reboot times need to be tested.
		Please input the reboot times.

config TESTCASE_REBOOT_PATH
	default "/data"
	string "reboot test path"
	help
		This mean which directory to run reboot test.

endif
```

## lichee/rtos-components/aw/tinatest/testcase/storage/Kconfig
```kconfig
config TESTCASE_NORTESTER
	bool "Nor Testcase."
	depends on DRIVERS_SPINOR || DRIVERS_FLASHC
	select COMPONENTS_AW_IOBOX
	select COMPONENTS_AW_IOBOX_RWCHECK
	select COMPONENTS_AW_IOBOX_RWSPEED
	default n

config TESTCASE_FULLDISK
	bool "FullDisk Testcase."
	depends on DRIVERS_SPINOR || DRIVERS_FLASHC
	select COMPONENTS_AW_IOBOX
	select COMPONENTS_AW_IOBOX_RWCHECK
	select COMPONENTS_AW_IOBOX_RWSPEED
	default n

if TESTCASE_FULLDISK
config TESTCASE_FULLDISK_PATH
	default "/data"
	string "fulldisk test path"
	help
		This mean which directory to run fulldisk test.

endif

config TESTCASE_SPEED
	bool "Speed Testcase."
	depends on DRIVERS_SPINOR || DRIVERS_FLASHC
	select COMPONENTS_AW_IOBOX
	select COMPONENTS_AW_IOBOX_RWCHECK
	select COMPONENTS_AW_IOBOX_RWSPEED
	default n

if TESTCASE_SPEED
config TESTCASE_SPEED_PATH
	default "/data"
	string "speed test path"
	help
		This mean which directory to run speed test.

endif

config TESTCASE_POWERFAIL
	bool "Powerfail Testcase."
	depends on DRIVERS_SPINOR || DRIVERS_FLASHC
	select COMPONENTS_AW_IOBOX
	select COMPONENTS_AW_IOBOX_RWCHECK
	select COMPONENTS_AW_IOBOX_RWSPEED
	default n

if TESTCASE_POWERFAIL
config TESTCASE_POWERFAIL_PATH
	default "/data"
	string "powerfail test path"
	help
		This mean which directory to run powerfail test.

config POWERFAIL_TIMES
	default "100000"
	string "powerfail times"
	help
		This means how many powerfail times need to be tested.
		Please input the powerfail times.

endif
```

## lichee/rtos-components/aw/tinatest/testcase/tp/Kconfig
```kconfig
config TESTCASE_TP
	bool "TOUCH SCREEN Testcase."
	depends on DRIVERS_TOUCHSCREEN
	default n
```

## lichee/rtos-components/aw/tinatest/testcase/uart/Kconfig
```kconfig
menuconfig TESTCASE_UART
	bool "UART Testcase."
	depends on DRIVERS_UART
	default n

if TESTCASE_UART
config UART_PORT
	default "2"
	string "uart port"
	help
		This means whitch port of the uart is to be tested.Please input "0/1/2/3/.etc"

config UART_BAUDRATE
	default "115200"
	string "uart baudrate"
	help
		This means how many baudrate uart to be tested.Please input "4800/9600/115200".

endif
```

## lichee/rtos-components/aw/tinatest/testcase/wifi/Kconfig
```kconfig
menu "WiFi Testcase"
	depends on DRIVERS_XRADIO

config TESTCASE_WIFION
	bool "Wifi on Testcase."
	default n

config TESTCASE_WIFIOFF
	bool "Wifi off Testcase."
	default n

config TESTCASE_WIFISCAN
	bool "Wifi scan Testcase."
	default n

config TESTCASE_WIFICON
	bool "Wifi connect Testcase."
	default n

config TESTCASE_WIFIRM
	bool "Wifi disconnect Testcase."
	default n

endmenu
```

## lichee/rtos-components/aw/usb/Kconfig
```kconfig
menu "USB Components Support"
source components/common/aw/usb/gadget/Kconfig
endmenu
```

## lichee/rtos-components/aw/usb/gadget/Kconfig
```kconfig
menuconfig DRIVER_GADGET
	bool "USB Gadget Support"
	default n

if DRIVER_GADGET
source components/common/aw/usb/gadget/adbd/Kconfig
source components/common/aw/usb/gadget/uacd/Kconfig
endif
```

## lichee/rtos-components/aw/usb/gadget/adbd/Kconfig
```kconfig
config COMPONENTS_USB_GADGET_ADBD
    bool "adbd service"
    select DRIVERS_USB_UDC
    default n
    help
	adbd service

config COMPONENTS_USB_GADGET_ADB_LOCAL_TRANSPORT
    bool "adb local transport"
    default n
    depends on COMPONENTS_USB_GADGET_ADBD

config ADB_LOCAL_TRANSPORT_PORT
    string "adb local transport port"
    default "5555"
    depends on COMPONENTS_USB_GADGET_ADB_LOCAL_TRANSPORT

config COMPONENTS_USB_GADGET_ADB_FORWARD
    bool "adb forward function"
    default n
    depends on  COMPONENTS_USB_GADGET_ADBD

config COMPONENTS_USB_GADGET_ADB_FORWARD_WITHOUT_SOCKET
    bool "adb forward function without socket"
    depends on COMPONENTS_USB_GADGET_ADB_FORWARD
    default n
```

## lichee/rtos-components/aw/usb/gadget/uacd/Kconfig
```kconfig
config COMPONENTS_USB_GADGET_UACD
    bool "uacd service"
    select DRIVERS_USB_UDC
    default n
    help
	uacd service

choice
    prompt "uacd audio function"
    depends on COMPONENTS_USB_GADGET_UACD
    default COMPONENTS_USB_GADGET_UACD_NONE

    config COMPONENTS_USB_GADGET_UACD_NONE
    bool "none"

    config COMPONENTS_USB_GADGET_UACD_WITH_AS
    bool "AudioSystem local audio"
    depends on COMPONENTS_AW_AUDIO_SYSTEM
    help
	uacd audio function with AudioSystem

    config COMPONENTS_USB_GADGET_UACD_WITH_ALSA
    bool "ALSA api local audio"
    depends on COMPONENTS_AW_TINY_ALSA_LIB || COMPONENTS_AW_ALSA_LIB
    help
	uacd audio function with alsa api

endchoice
```

## lichee/rtos-components/aw/virt_log/Kconfig
```kconfig
menuconfig COMPONENTS_VIRT_LOG
	bool "virtual log"
	default n

if COMPONENTS_VIRT_LOG
config COMPONENTS_VIRT_LOG_SIZE
	int "virt log buffer size(unit:Kb)"
	default 4

config COMMAND_DMESG
    bool "Dmesg Command to show virt log buffer"
	default n

endif
```

## lichee/rtos-components/aw/wireless/Kconfig
```kconfig
menu "wireless"
		config COMPONENTS_WIRELSEE_COMMON
			bool "wireless common"
			depends on COMPONENTS_WIFIMANAGER || COMPONENTS_BTMANAGER
			default y if COMPONENTS_WIFIMANAGER || COMPONENTS_BTMANAGER

		menuconfig COMPONENTS_WIFIMANAGER
			bool wifimanager-v2.0
			default n
source "components/common/aw/wireless/wifimanager/Kconfig"

		menuconfig COMPONENTS_BTMANAGER
			bool "btmanager"
			depends on COMPONENT_BT
			default n
			if COMPONENTS_BTMANAGER

				config COMPONENT_BTMG_CORE
					bool "btmg core"
					depends on COMPONENTS_BTMANAGER
					depends on COMPONENTS_SPEEXDSP
					default y
				help
				support btmg core

			if COMPONENT_BTMG_CORE

				config A2DP_USE_AUDIO_SYSTEM
					bool "Enable AudioTrack send audio data"
					default n

			endif

				config COMPONENT_BTMG_CMD
					bool "btmg cmd"
					depends on COMPONENTS_BTMANAGER
					default y
				help
					support btmg cmd

			endif
endmenu
```

## lichee/rtos-components/aw/wireless/wifimanager/Kconfig
```kconfig
menu "Wifimanager-v2.0 Configuration"
	depends on (PACKAGE_wifimanager-v2.0 || COMPONENTS_WIFIMANAGER)

config WMG_PROTOCOL_SOFTAP
	bool "CONFIG_WMG_PROTOCOL_SOFTAP"
	depends on (PACKAGE_wifimanager-v2.0 || COMPONENTS_WIFIMANAGER)
	default n
	help
		softap net config.

config WMG_PROTOCOL_BLE
	bool "CONFIG_WMG_PROTOCOL_BLE"
	depends on (PACKAGE_wifimanager-v2.0 || COMPONENTS_WIFIMANAGER)
	default n
	help
		ble net config.

config WMG_PROTOCOL_XCONFIG
	bool "CONFIG_WMG_PROTOCOL_XCONFIG"
	depends on (PACKAGE_wifimanager-v2.0 || COMPONENTS_WIFIMANAGER)
	default n
	help
		xconfig net config.

config WMG_PROTOCOL_SOUNDWAVE
	bool "CONFIG_WMG_PROTOCOL_SOUNDWAVE"
	depends on (PACKAGE_wifimanager-v2.0 || COMPONENTS_WIFIMANAGER)
	default n
	help
		soundwave net config.

choice
	prompt "Wifimanager support platform"
	default WMG_PLATFORM_LINUX
config WMG_PLATFORM_LINUX
	bool "LINUX PLATFORM OS"
config WMG_PLATFORM_FREERTOS
	bool "FREERTOS PLATFORM OS"
config WMG_PLATFORM_XRLINK
	bool "XRLINK PLATFORM OS"
endchoice

config WMG_UNREGISTER_CB
	bool "Wifimanager unregister callback function"
	depends on (PACKAGE_wifimanager-v2.0 || COMPONENTS_WIFIMANAGER)
	default y
		help
			Wifimanager unregister callback function.

config WMG_SUPPORT_EXPAND
	bool "Wifimanager support send expand cmd"
	depends on (PACKAGE_wifimanager-v2.0 || COMPONENTS_WIFIMANAGER)
	default n
		help
			Wifimanager support send expand cmd.

menu "Wifimanager support mode Configuration"
config WMG_SUPPORT_STA_MODE
	bool "Wifimanager support sta mode enable"
	depends on (PACKAGE_wifimanager-v2.0 || COMPONENTS_WIFIMANAGER)
	default y
		help
			Wifimanager support sta mode.

config WMG_SUPPORT_AP_MODE
	bool "Wifimanager support ap mode enable"
	depends on (PACKAGE_wifimanager-v2.0 || COMPONENTS_WIFIMANAGER)
	default y
		help
			Wifimanager support ap mode.

config WMG_SUPPORT_MONITOR_MODE
	bool "Wifimanager support monitor mode enable"
	depends on (PACKAGE_wifimanager-v2.0 || COMPONENTS_WIFIMANAGER)
	default n
		help
			Wifimanager support monitor mode.

config WMG_SUPPORT_P2P_MODE
	bool "Wifimanager support p2p mode enable"
	depends on (PACKAGE_wifimanager-v2.0 || COMPONENTS_WIFIMANAGER)
	default n
		help
			Wifimanager support p2p mode.
endmenu

choice
	prompt "Wifimanager set default debug level"
	default WMG_DEFAULT_DEBUG_LV_INFO
config WMG_DEFAULT_DEBUG_LV_ERROR
	bool "default debug level: error"
config WMG_DEFAULT_DEBUG_LV_WARN
	bool "default debug level: to warn"
config WMG_DEFAULT_DEBUG_LV_INFO
	bool "default debug level: to info"
config WMG_DEFAULT_DEBUG_LV_DEBUG
	bool "default debug level: to debug"
config WMG_DEFAULT_DEBUG_LV_DUMP
	bool "default debug level: to dump"
config WMG_DEFAULT_DEBUG_LV_EXCE
	bool "default debug level: to exce"
endchoice

endmenu
```

## lichee/rtos-components/thirdparty/Kconfig
```kconfig
source components/common/thirdparty/md5/Kconfig
source components/common/thirdparty/littlevgl-8/Kconfig
source components/common/thirdparty/openamp/Kconfig
source components/common/thirdparty/cjson/Kconfig
source components/common/thirdparty/uuid/Kconfig
source components/common/thirdparty/env/Kconfig
source components/common/thirdparty/coremark/Kconfig
source components/common/thirdparty/dhrystone/Kconfig
source components/common/thirdparty/whetstone/Kconfig
source components/common/thirdparty/tinycrypt/Kconfig
source components/common/thirdparty/opus/Kconfig
source components/common/thirdparty/network/Kconfig
source components/common/thirdparty/bluetooth/Kconfig
source components/common/thirdparty/unity/Kconfig
source components/common/thirdparty/linpack/Kconfig
source components/common/thirdparty/pi_css5_src/Kconfig
source components/common/thirdparty/freetype/Kconfig
source components/common/thirdparty/speexdsp/Kconfig
source components/common/thirdparty/libjpeg-turbo/Kconfig
source components/common/thirdparty/giflib/Kconfig
```

## lichee/rtos-components/thirdparty/bluetooth/Kconfig
```kconfig
menuconfig COMPONENT_BT
	bool "bluetooth"
	default n
	help
	  support bluetooth.
	  If unsure, say Y.

config BT_XR_IMPL
	bool
	default y if COMPONENT_BT

if COMPONENT_BT

menuconfig COMPONENTS_ZEPHYR
	bool "Zephyr"
	select NET_BUF
	default y
	help
	  This option enables Zephyr Bluetooth host support.

if COMPONENTS_ZEPHYR
source components/common/thirdparty/bluetooth/zephyr/Kconfig
endif

menuconfig COMPONENTS_BLUEDROID
	bool "Bluedroid"
	default y
	help
	  This option enables Bluedroid Bluetooth host support.

if COMPONENTS_BLUEDROID
source components/common/thirdparty/bluetooth/bluedroid/Kconfig
endif

config BT_DUAL_HOST
	bool
	default y if COMPONENTS_ZEPHYR && COMPONENTS_BLUEDROID

source components/common/thirdparty/bluetooth/rtlbt/Kconfig
#source components/common/thirdparty/bluetooth/zblue/Kconfig

if COMPONENTS_BLUEDROID || COMPONENTS_ZEPHYR
config COMPONENTS_BT_PM
	bool "bt host pm"
	depends on COMPONENTS_PM
	default y if COMPONENTS_PM
	help
	  This option enables bt host pm.

config BT_PM_LOG_LEVEL
	int "bt host pm log level"
	depends on COMPONENTS_BT_PM
	default 2
	help
	  This option set bt host pm level.0:ERROR 1:WARNING 2:DEBUG 3:INFO
endif
endif
```

## lichee/rtos-components/thirdparty/bluetooth/bluedroid/Kconfig
```kconfig
if COMPONENTS_BLUEDROID
config BT_ENABLED
    bool "Bluedroid enable"
    depends on COMPONENTS_BLUEDROID
    default y
    help
        Select this option to enable Bluedroid and show the submenu with Bluedroid configuration choices.

config BT_BLUEDROID_ENABLED
    bool "Bluedroid - Dual-mode"
    depends on COMPONENTS_BLUEDROID
    default y
    help
        This option is recommended for classic Bluetooth or for dual-mode
        usecases

config BT_HOST
    bool "Bluedroid Host"
    default BT_BLUEDROID_ENABLED
    default y
    help
        This helps to enable Bluetooth host stack

menu "Bluedroid-BT Options"
    visible if BT_BLUEDROID_ENABLED

    source "components/common/thirdparty/bluetooth/bluedroid/host/bluedroid/Kconfig.in"
endmenu

if !BT_DUAL_HOST
menuconfig BLE_MESH
    bool "XRAIDO BLE Mesh Support"
    depends on BT_ENABLED
    help
        This option enables XRAIDO BLE Mesh support. The specific features that are
        available may depend on other features that have been enabled in the
        stack, such as Bluetooth Support, Bluedroid Support & GATT support.

source "components/common/thirdparty/bluetooth/bluedroid/xr_ble_mesh/Kconfig.in"

endif

menu XRADIO_COMMON

config HCI_LAYER_RX
    bool "HCI LAYER RX support"
    depends on BT_DUAL_HOST
    default y if BT_DUAL_HOST
    help
        This option enable hci rx thread.

config HCILOG_ENABLE
    bool "hcilog enable"
    depends on BT_DRIVERS_LOG
    default y if BT_DRIVERS_LOG
    help
        This option enable bluedroid hcilog feature.

config BT_SRC_PROCESS
    bool "A2dp source process feature support"
    default y
    help
        This option process a2dp source thread.

config BTTRC_DUMP_BUFFER
    int "hcidmp buffer"
    default 1
    help
        This option set hcidump buff.

config BLUEDROID_USE_SETTINGS
    bool "bluedroid use settings"
    default y
    help
        This option set bluedroid use settings.

config BLUEDROID_MAX_STORE_VALUE
    int "bluedroid max store value"
    default 8
    help
        This option set bluedroid max store value.

config FILE_MAX_SIZE
    int "bluedroid max file size"
    default 1536
    help
        This option set bluedroid max file size.

config FILE_DEFAULE_LENGTH
    int "bluedroid file defaule length"
    default 2048
    help
        This option set bluedroid file defaule length.

config KEY
    string "bluedroid store key name"
    default "bt_cfg_key"
    help
        This option set bluedroid store key name.

config BLUEDRIOD_LOG_DEFAULT_LEVEL
    int "bluedroid log defaule level"
    default 2
    help
        This option set bluedroid log defaule level.
endmenu
endif
```
