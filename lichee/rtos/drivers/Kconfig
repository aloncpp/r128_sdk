## lichee/rtos/drivers/Kconfig
```kconfig
comment "Configure all required driver sub-systems"

menu "soc related device drivers"

config DRIVERS_CHIP
    bool
    default y

source drivers/rtos-hal/hal/source/common/Kconfig

source drivers/rtos-hal/hal/source/timer/Kconfig

source drivers/rtos-hal/hal/source/rtc/Kconfig

source drivers/rtos-hal/hal/source/watchdog/Kconfig

source drivers/rtos-hal/hal/source/uart/Kconfig

source drivers/rtos-hal/hal/source/lpuart/Kconfig

source drivers/rtos-hal/hal/source/ledc/Kconfig

source drivers/rtos-hal/hal/source/lradc/Kconfig

source drivers/rtos-hal/hal/source/gpadc/Kconfig

source drivers/rtos-hal/hal/source/pwm/Kconfig

source drivers/rtos-hal/hal/source/sysctl/Kconfig

source drivers/rtos-hal/hal/source/gpio/Kconfig

source drivers/rtos-hal/hal/source/dma/Kconfig

source drivers/rtos-hal/hal/source/efuse/Kconfig

source drivers/rtos-hal/hal/source/sound/Kconfig

source drivers/rtos-hal/hal/source/regulator/Kconfig

source drivers/rtos-hal/hal/source/lspsram/Kconfig

source drivers/rtos-hal/hal/source/power/Kconfig

source drivers/rtos-hal/hal/source/thermal/Kconfig

source drivers/rtos-hal/hal/source/spi/Kconfig

source drivers/rtos-hal/hal/source/spi_camera/Kconfig

source drivers/rtos-hal/hal/source/spinor/Kconfig

source drivers/rtos-hal/hal/source/dbi/Kconfig

source drivers/rtos-hal/hal/source/spilcd/Kconfig

source drivers/rtos-hal/hal/source/sdmmc/Kconfig

source drivers/rtos-hal/hal/source/ccmu/Kconfig

source drivers/rtos-hal/hal/source/ce/Kconfig

source drivers/rtos-hal/hal/source/usb/Kconfig

source drivers/rtos-hal/hal/source/mbus/Kconfig

source drivers/rtos-hal/hal/source/twi/Kconfig

source drivers/rtos-hal/hal/source/nand_flash/Kconfig

source drivers/rtos-hal/hal/source/prcm/Kconfig

source drivers/rtos-hal/hal/source/flashc/Kconfig

source drivers/rtos-hal/hal/source/hwspinlock/Kconfig

source drivers/rtos-hal/hal/source/trng/Kconfig

source drivers/rtos-hal/hal/source/msgbox/Kconfig

source drivers/rtos-hal/hal/source/csi/Kconfig

source drivers/rtos-hal/hal/source/rccal/Kconfig

source drivers/rtos-hal/hal/source/disp2/Kconfig

source drivers/rtos-hal/hal/source/g2d_rcq/Kconfig

source drivers/rtos-hal/hal/source/cir/Kconfig

source drivers/rtos-hal/hal/source/cir_tx/Kconfig

source drivers/rtos-hal/hal/source/smartcard/Kconfig

endmenu

menu "other drivers"
config DRIVERS_DRV
    bool
    default y

source drivers/drv/Kconfig

endmenu
```

## lichee/rtos/drivers/drv/Kconfig
```kconfig
source drivers/drv/rfkill/Kconfig

source drivers/drv/cpufreq/Kconfig

source drivers/drv/dram/Kconfig

source drivers/drv/wireless/Kconfig

source drivers/drv/leds/Kconfig

source drivers/drv/input/Kconfig

source drivers/drv/mutekey/Kconfig

source drivers/drv/uart/Kconfig

source drivers/drv/bluetooth/Kconfig

source drivers/drv/fdcm/Kconfig
```

## lichee/rtos/drivers/drv/bluetooth/Kconfig
```kconfig
menu "bluetooth drivers"
config DRIVERS_BLUETOOTH_XRADIO
	default n
	bool "BLUETOOTH xradio driver"

if DRIVERS_BLUETOOTH_XRADIO

config BT_DRIVERS_LIB
	bool "Enable Blutooth Drivers Lib"
	default y
	help
		this will use blutooth drivers lib.

source drivers/drv/bluetooth/driver/Kconfig

config BT_DRIVERS_LOG
	bool "Enable Blutooth Drivers HCI Log Parse"
	default n
	help
		this will use blutooth drivers hci log parse.

	if BT_DRIVERS_LOG

		config BT_DRIVERS_LOG_HCIDUMP
			bool "Enable Blutooth Drivers Log hcidump"
			default n

		config BT_DRIVERS_LOG_BTSNOOP
			bool "Enable Blutooth Drivers Log btsnoop"
			default n

		if BT_DRIVERS_LOG_BTSNOOP
			config BT_DRIVERS_LOG_EXTRA_STACK_SIZE
				int "The extra thread stack size of using FileSystem"
				default 512
		endif

	endif

choice
	prompt "Distribution method"
	default BT_DIST_MODE_CORRESPOND

config BT_DIST_MODE_ALL
	bool "Distribute ALL"

config BT_DIST_MODE_CORRESPOND
	bool "Distribute Corresponding"

endchoice

if BT_DIST_MODE_CORRESPOND
config BT_DIST_MODE_CORRESPOND_DEBUG
	bool "corresponding mode debug log"
	default n
	help
	  If this option is enabled, would should corresponding mode debug log.
endif

config BT_DRIVERS_LIB_LOG_LEVEL
	int "Blutooth Drivers Lib Log Level"
	default 2
	help
	  this will set blutooth drivers lib log level.

endif
endmenu
```

## lichee/rtos/drivers/drv/bluetooth/driver/Kconfig
```kconfig
if BT_DRIVERS_LIB

source drivers/drv/bluetooth/driver/controller/Kconfig

source drivers/drv/bluetooth/driver/interface/Kconfig

endif
```

## lichee/rtos/drivers/drv/bluetooth/driver/controller/Kconfig
```kconfig
choice
	prompt "Bluetooth Driver Controller"
	default XRADIO_BT_CONTROLLER

config XRADIO_BT_CONTROLLER
	bool "Xradio BT Controller"
	default y
	help
	  If this option is enabled, Xradio BT Controller is used.

endchoice

if XRADIO_BT_CONTROLLER
menu "xradio bt controller"
	source drivers/drv/bluetooth/driver/controller/xradio/Kconfig
endmenu
endif
```

## lichee/rtos/drivers/drv/bluetooth/driver/controller/xradio/Kconfig
```kconfig
choice
	prompt "XRADIO Driver Controller"
	default SUN20IW2_BT_CONTROLLER

config SUN20IW2_BT_CONTROLLER
	bool "SUN20IW2 BT Controller"
	help
	  If this option is enabled, Xradio Sun20iw2 BT Controller is used.

endchoice

if SUN20IW2_BT_CONTROLLER
menu "sun20iw2 bt controller"
	source drivers/drv/bluetooth/driver/controller/xradio/sun20iw2/Kconfig
endmenu
endif
```

## lichee/rtos/drivers/drv/bluetooth/driver/controller/xradio/sun20iw2/Kconfig
```kconfig
choice
	prompt "Sun20iw2 Driver Controller"
	default DRIVER_SUN20IW2_BT_CONTROLLER

config DRIVER_SUN20IW2_BT_CONTROLLER
	bool "Sun20iw2 BT Controller"
	help
	  If this option is enabled, Sun20iw2 BT Controller is used.

config DRIVER_SUN20IW2_BT_CONTROLLER_BLE_ONLY
	bool "Sun20iw2 BLE Only Controller"
	help
	  If this option is enabled, Sun20iw2 BLE only Controller is used.

endchoice
```

## lichee/rtos/drivers/drv/bluetooth/driver/interface/Kconfig
```kconfig
choice
	prompt "Bluetooth Driver Interface"
	default BT_VHCI

config BT_VHCI
	bool "Virtual HCI"
	help
	  If this option is enabled, virtual hci is used.

config BT_UART
	bool "UART HCI"
	help
	  If this option is enabled, uart hci is used.

endchoice
```

## lichee/rtos/drivers/drv/cpufreq/Kconfig
```kconfig
menu "CPUFREQ Devices"

config DRIVERS_CPUFREQ
    bool "enable cpufreq device drivers"
        default n

endmenu
```

## lichee/rtos/drivers/drv/dram/Kconfig
```kconfig
menu "Dram Devices"

config DRIVERS_DRAM
    bool "enable dram device drivers"
    default y

endmenu
```

## lichee/rtos/drivers/drv/fdcm/Kconfig
```kconfig
menu "fdcm Devices"

config DRIVERS_FDCM
    bool "enable fdcm device drivers"
    default n
    depends on DRIVERS_FLASHC

endmenu
```

## lichee/rtos/drivers/drv/input/Kconfig
```kconfig
menuconfig DRIVERS_INPUT
	default n
	bool "input driver"

if DRIVERS_INPUT

	source drivers/drv/input/keyboard/Kconfig

	source drivers/drv/input/tp/Kconfig

endif
```

## lichee/rtos/drivers/drv/input/keyboard/Kconfig
```kconfig
menuconfig DRIVERS_KEYBOARD
	default n
	bool "keyboard driver"

if DRIVERS_KEYBOARD

config DRIVERS_SUNXI_KEYBOARD
    bool "enable sunxi-keyboard drivers"
        default n

config DRIVERS_GPIO_KEY_POLLED
    bool "enable gpio key polled drivers"
        default n

config DRIVERS_GPADC_KEY
    bool "enable gpadc key drivers"
	default n

endif
```

## lichee/rtos/drivers/drv/input/tp/Kconfig
```kconfig
menuconfig DRIVERS_TOUCHSCREEN
	default n
	bool "touchscreen driver"

if DRIVERS_TOUCHSCREEN

config DRIVERS_TOUCHSCREEN_TLSC6X
    bool "enable tlsc6x touchscreen driver"
    default n

config DRIVERS_TOUCHSCREEN_GT911
    bool "enable gt911 touchscreen driver"
    default n

config DRIVERS_TOUCHSCREEN_CST226SE
    bool "enable cst226se touchscreen driver"
    default n

config DRIVERS_TEST_TOUCHSCREEN
    bool "enable touchscreen drivers APIs test command"
    default n

endif
```

## lichee/rtos/drivers/drv/leds/Kconfig
```kconfig
menuconfig DRIVERS_LEDS
	default n
	bool "leds driver"

if DRIVERS_LEDS

config DRIVERS_LEDS_SUNXI
    bool "enable sunxi leds drivers"
        default n

config DRIVERS_PWM_LEDS
    bool "enable sunxi pwm leds drivers"
        default n

endif
```

## lichee/rtos/drivers/drv/mutekey/Kconfig
```kconfig
menuconfig DRIVERS_MUTEKEY
	default y
	bool "mutekey driver"

if DRIVERS_MUTEKEY

config DRIVERS_MUTEKEY_GPIO
    bool "enable gpio mutekey drivers"
    default y

endif
```

## lichee/rtos/drivers/drv/uart/Kconfig
```kconfig
menuconfig DRIVERS_UART_DEVFS
	default y
	bool "sunxi uart driver for devfs"
	depends on COMPONENTS_AW_DEVFS
```

## lichee/rtos/drivers/drv/wireless/Kconfig
```kconfig
menuconfig DRIVERS_WIRELESS
	default n
	bool "wireless devices"

if DRIVERS_WIRELESS

config DRIVERS_RTL8723DS
	select USE_SDIO
	select SDIO_IRQ
    bool "enable rtl8723ds device drivers"
        default n

source drivers/drv/wireless/xradio/Kconfig

endif #DRIVERS_WIRELESS
```

## lichee/rtos/drivers/drv/wireless/xradio/Kconfig
```kconfig
#
# Wlan configuration
#

menuconfig DRIVERS_XRADIO
	default n
	select COMPONENTS_MBEDTLS
	bool "XRADIO driver"

if DRIVERS_XRADIO

config DRIVERS_XRADIO_CMD
	bool "Enable xradio test cmd"
	default y
	select NEWLIBC_NANO_SCANF_FLOAT if ARCH_SUN20IW2P1
	help
		this will use xradio test cmd.

choice XRADIO_CHIP
	default DRIVER_R128 if ARCH_SUN20IW2P1
	default DRIVER_XR829
	prompt "Xradio chip"
	help
		Specify the xradio chip.

config DRIVER_XR819
	bool "Enable xr819 driver"
	depends on DRIVERS_XRADIO
	help
		this will use xr819 chip.

config DRIVER_XR819S
	bool "Enable xr819s driver"
	depends on DRIVERS_XRADIO
	help
		this will use xr819s chip.

config DRIVER_XR829
	bool "Enable xr829 driver"
	depends on DRIVERS_XRADIO
	help
		this will use xr829 chip.

config DRIVER_R128
	bool "Enable r128 driver"
	depends on ARCH_SUN20IW2P1
	help
		this will use r128 chip.
endchoice

config XR829_40M_FW
	bool "Use Firmware 40M for XR829"
	depends on DRIVER_XR829
	default y
	help
		this will use xr829 chip

config XR819S_40M_FW
    bool "Use Firmware 40M for XR819S"
    depends on DRIVER_XR819S
    default y
    help
               this will use xr819s chip
# Wi-Fi Certification of WFA
config WIFI_CERTIFIED
    bool "Wi-Fi Certification of WFA"
    default y
    help
        If this option is enabled,  Wi-Fi Certification of WFA used.

# wlan station mode
config WLAN_STA
    bool "wlan station mode"
    default y
    help
        If this option is enabled, WLAN STA mode used.

config WLAN_STA_WPS
    bool "wlan station mode with wps support"
	depends on WLAN_STA
    default n
    help
        If this option is enabled, WLAN STA WPS used.

# wlan monitor mode
config WLAN_MONITOR
    bool "wlan monitor mode"
    default y
    help
        If this option is enabled, WLAN Monitor mode used.

# wlan hostap mode
config WLAN_AP
    bool "wlan ap mode"
    default y
    help
        If this option is enabled, WLAN AP mode used.

choice
	prompt "select freq trim src"
	depends on ARCH_SUN20IW2P1
	default FREQ_TRIM_FROM_SDD
	help
		select freq trim/offset source

config FREQ_TRIM_FROM_SDD
	bool "SDD file"

endchoice

# wlan ETF test using ETF command line interface
config ETF_CLI
    bool
    default n

# wlan ETF test
config ETF
    bool "wlan ETF test"
	select ETF_CLI
	select NEWLIBC_NANO_SCANF_FLOAT if ARCH_SUN20IW2P1
	select NEWLIBC_NANO_PRINTF_FLOAT if ARCH_SUN20IW2P1
	#select WLAN_SHARE_RAM
	#select WLAN_SHARE_RAM_SIZE_128K
    default n
    help
        If this option is enabled, WLAN ETF test used.

# Wlan use small stack
config WLAN_SMALL_STACK_SIZE
	bool
	default n
	help
		use small stack in some CPU ARCH.

# Mbuf implementation mode
config MBUF_IMPL_MODE
	int
	default 0
	help
		0: continuous memory allocated from heap, 1: continuous memory allocated from lwip pbuf.

endif
```

## lichee/rtos/drivers/osal/Kconfig
```kconfig
menu "HAL OSAL API"

config HAL_OSAL
    bool "enable osal API for hal"
	default y

endmenu
```
