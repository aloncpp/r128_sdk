## lichee/rtos/components/aw/memleak/Kconfig
```kconfig
menu "Memleak Components Support"

config COMPONENTS_MEMLEAK
    bool "Tina RTOS Memleak"
    default n
    help
        Tina RTOS Memleak support.

if COMPONENTS_MEMLEAK
config MEMORY_LEAK_BACKTRACE_LEVEL
    int "Tina RTOS Memleak Backtrace Level"
    default 16
    help
        Tina RTOS Memleak Backtrace Level.

config DOUBLE_FREE_CHECK
    bool "Tina RTOS Double Free Check"
    default y
    help
        Tina RTOS Double Free Check Tools.

endif

endmenu
```

## lichee/rtos/components/aw/multimedia/Kconfig
```kconfig
menu "aw multimedia"
config RTPLAYER_TEST
#    select COMPONENTS_AW_ALSA_LIB
#    select COMPONENT_VFS
#    select COMPONENTS_TCPIP
    select COMPONENTS_LWIP
    select COMPONENTS_MBEDTLS
	select LIB_MULTIMEDIA
	depends on DRIVERS_SOUND
	bool "test rtplayer demo"
    default n

config RTPLAYER_DIRPLAY
    bool "rtplayer support dirplay"
    default y
    depends on RTPLAYER_TEST

config TOTAL_AUDIO_NUM
    int "set max num of dir-play supporting"
    depends on RTPLAYER_DIRPLAY
    default 30

config RTRECORDER_TEST
    bool "test cedarx recorder demo"
	select LIB_RECORDER
	depends on DRIVERS_SOUND
    default n

config RTOPUS_TEST
    bool "test opus encode and decode demo"
    default n

config PLAY_FIFO
	bool "rtos multimedia play fifo demo"
	select LIB_MULTIMEDIA
	depends on DRIVERS_SOUND
	default n

config LIB_MULTIMEDIA
	bool "libs for multimedia"
	default n

config LIB_RECORDER
	bool "libs for recorder"
	default n

endmenu
```

## lichee/rtos/components/aw/newlibc/Kconfig
```kconfig
menu "Newlibc Components Support"

config ARCH_MEMCPY_OPTIMIZE
    bool "Tina RTOS Memcpy Optimize"
    default y

endmenu
```

## lichee/rtos/components/aw/ostest/Kconfig
```kconfig
menu "Os Testcase Support"

config COMPONENTS_OSTEST
    bool "Os Testcase"
    default n
    help
        Tina RTOS Os Testcase support.

if COMPONENTS_OSTEST

config COMPONENTS_OSTEST_FPU
    bool "FPU Testcase"
    default n

config SHOW_C906_FPU_CTX_STATISTICS_INFO
    bool "Provide command to print C906 FPU context statistics info"
    depends on RECORD_C906_FPU_CTX_STATISTICS
    default n

config COMPONENTS_OSTEST_JPEGPERF
    bool "JPEGPERF Testcase"
    default n

config COMPONENTS_OSTEST_HARDWARE_PERF
    bool "HARDWARE performance"
    select DRIVERS_TIMER
    default n

config COMPONENTS_OSTEST_OSAL
    bool "Osal Testcase"
    default n

endif

endmenu
```

## lichee/rtos/components/aw/pstore/Kconfig
```kconfig
menuconfig COMPONENTS_PSTORE
    bool "pstore support"
    default n
    select DRIVERS_SPINOR_PANIC_WRITE
    help
        Pstore Components.

if COMPONENTS_PSTORE

config PSTORE_BUFFER_SIZE
    int "pstore buffer size(byte)"
    default 4096

endif
```

## lichee/rtos/components/aw/ramfs/Kconfig
```kconfig
menu "RamFs Components Support"

config COMPONENTS_RAMFS
    bool "Tina RTOS RamFs"
    default y
    help
        Tina RTOS RamFs support.

config COMPONENTS_RAMFS_AUTO_MOUNT
    bool "Tina RTOS RamFs Auto Mount"
    default y
	depends on COMPONENTS_RAMFS
    help
        Tina RTOS RamFs Auto Mount Flag.

config COMPONENTS_RAMFS_PATH
    string "Tina RTOS RamFs Mount Path"
    default "/tmp"
	depends on COMPONENTS_RAMFS
    help
        Tina RTOS RamFs Mount Path.

config COMPONENTS_RAMFS_SIZE
    int "Tina RTOS RamFs Mount Size(Kbytes)"
	default 512
	depends on COMPONENTS_RAMFS
    help
        Tina RTOS RamFs Mount Size.

endmenu
```

## lichee/rtos/components/aw/secure_storage/Kconfig
```kconfig
config COMPONENTS_AW_SS
    bool "Secure Storage"
    select DRIVERS_CE
    default n
    help
	secure storage demo

config COMPONENT_SECURE_STORAGE
    bool "Flashc Secure Storage"
    depends on (ARCH_ARM && FLASHC_ENC && DRIVERS_FLASHC && COMPONENTS_AW_BLKPART) || ARCH_RISCV
    default n

config SECURE_STORAGE_SSK_KEY
	bool "Secure Storage using ssk key"
	depends on COMPONENT_SECURE_STORAGE
	default n
```

## lichee/rtos/components/aw/smartlink/Kconfig
```kconfig
menu "aw smartlink"

config COMPONENTS_SMARTCONFIG
	bool "smartconfig"
    select COMPONENTS_LWIP
    select COMPONENTS_MBEDTLS
	default n

config COMPONENTS_BLINK
	bool "blink"
	default n

config COMPONENTS_SOFT_AP_CONFIG
	bool "soft ap config"
    select COMPONENTS_LWIP
    select COMPONENTS_MBEDTLS
	default n

config COMPONENTS_VOICE_PRINT
	bool "voice print"
	default n

endmenu
```

## lichee/rtos/components/aw/tfm/Kconfig
```kconfig
menu "TFM Support"

config COMPONENTS_TFM
    bool "TFM support"
    default n
    depends on ARCH_ARM_CORTEX_M33
    help
        TFM support.

if COMPONENTS_TFM

config COMPONENTS_TFM_TEST
    bool "TFM test demo"
    default n
    depends on COMPONENTS_TFM
    help
        TFM test demo.

config COMPONENTS_TFM_DEBUG
    bool "TFM debug demo"
    default n
    depends on COMPONENTS_TFM
    help
        TFM debug demo.

endif

endmenu
```

## lichee/rtos/components/aw/watchpoint/Kconfig
```kconfig
menu "Watchpoint Components Support"

config COMPONENTS_WATCHPOINT
    bool "Tina RTOS Watchpoint"
    default y
    help
        Tina RTOS Watchpoint support.
endmenu
```

## lichee/rtos/components/aw/wireless_video/Kconfig
```kconfig
menu "wireless_video"

		config COMPONENTS_WIRELESS_VIDEO
			bool "Wireless video demo"
			default n

endmenu
```

## lichee/rtos/components/thirdparty/Kconfig
```kconfig
source components/thirdparty/common/Kconfig

source components/thirdparty/console/Kconfig

source components/thirdparty/ulog/Kconfig

source components/thirdparty/cplusplus/Kconfig

source components/thirdparty/smartlink/Kconfig

source components/thirdparty/vfs/Kconfig

source components/thirdparty/spiffs/Kconfig

source components/thirdparty/lfs/Kconfig

source components/thirdparty/sona_audioaef/Kconfig

source components/thirdparty/finsh_cli/Kconfig

source components/thirdparty/io_multiplex/Kconfig

source components/thirdparty/elmfat/Kconfig

source components/thirdparty/speex/Kconfig
```

## lichee/rtos/components/thirdparty/common/Kconfig
```kconfig
menu "common component"

config COMPONENT_COMMON
    bool "printf support"
    default y

choice
    prompt "printf selection"
    default NEWLIBC_PRINTF

    config NEWLIBC_PRINTF
        bool "newlibc printf"

    config TINY_PRINTF
        bool "tiny printf"

endchoice

config CUSTOM_VSPRINTF
    bool "custom vsprintf"
    default n

endmenu
```

## lichee/rtos/components/thirdparty/console/Kconfig
```kconfig
menu "command-line interface"

config COMPONENT_CLI
    bool "command-line interface support"
    select COMPONENT_CLI_COMMANDS
    default y

config COMPONENT_CLI_COMMANDS
    bool "command-line command support"
    default y

config COMMAND_MISC
    bool "misc command"
    default y

if COMPONENT_CLI_COMMANDS

if COMMAND_MISC

config COMMAND_SAMPLE
    bool "sample command"
    default n

config COMMAND_REBOOT
    bool "reboot command"
    select DRIVERS_WATCHDOG
    select DRIVERS_RTC
    default y

config COMMAND_FORK
    bool "fork command"
    default y

config COMMAND_EFUSE_TEST
    bool "efsue_test command"
    depends on DRIVERS_EFUSE
    default n

config COMMAND_TOP
    bool "top command"
    default y

config COMMAND_MTOP
    bool "mtop command"
    select DRIVERS_MBUS
    default y

config COMMAND_MAHB
    bool "mahb command"
    select DRIVERS_AHB
    default n

config COMMAND_UPGRADE
    bool "upgrade command"
    depends on DRIVERS_PRCM
    select DRIVERS_WATCHDOG
    default y

config COMMAND_VERSION
	bool "version command"
    default y

config COMMAND_REG_WRITE
	bool "register write command"
    default y

config COMMAND_REG_READ
	bool "register read command"
    default y

config COMMAND_TEST_CACHE
	bool "test cache command"
    default n

config COMMAND_HELP
	bool "help command"
    default y

config COMMAND_CLEAN
	bool "clean command"
    default y

config COMMAND_MEM_LAYOUT
	bool "memory layout command"
    default y

config COMMAND_DATE
	bool "date command"
    default y

config COMMAND_TIMEDATECTL
	bool "timectl command"
    default y

config COMMAND_TZSET
	bool "tzset command"
    default n

config COMMAND_KTIME
    bool "ktime command"
    default n

config COMMAND_FREE
	bool "free command"
    default y

config COMMAND_CLOCK_TIME
	bool "clock time command"
    default y

config COMMAND_PANIC
    bool "painc command"
    default n

config COMMAND_BOOT_C906
    bool "boot c906 command"
    default n

config COMMAND_BOOT_DSP
    bool "boot dsp command"
    default n

config COMMAND_TASK_STATUS
    bool "task status command"
    default y

config COMMAND_NOR_READ
    bool "nor read command"
    default n

config COMMAND_NOR_ERASE
    bool "nor erase command"
    default n

config COMMAND_NOR_WRITE
    bool "nor write command"
    default n

config COMMAND_MMC_READ
    bool "mmc read command"
    depends on DRIVERS_SDMMC
    default n

config COMMAND_MMC_WRITE
    bool "mmc write command"
    depends on DRIVERS_SDMMC
    default n

config COMMAND_DCACHE_CLEAN
    bool "dcache clean command"
    default n

config COMMAND_DCACHE_INVALIDATE
    bool "dcache invalidate command"
    default n

config COMMAND_EXEC
    bool "execute file"
    default n

endif

config COMMAND_ARCH_RISCV_PMU
    bool "riscv pmu command"
    depends on ARCH_RISCV_PMU
    default n

config COMMAND_MEMTESTER
	bool "memtester command"
    default n

config COMMAND_CSR
    bool "csr command"
    default n

config COMMAND_LIST_IRQ
    bool "list irq command"
    default n

config COMMAND_DCDC_SWITCH
    bool "switch DCDC source command"
    default n

endif

endmenu
```

## lichee/rtos/components/thirdparty/cplusplus/Kconfig
```kconfig
menu "cplusplus interface"

config COMPONENT_CPLUSPLUS
    bool "cplusplus interface support"
    default y

config COMPONENTS_CPLUSPLUS_UNWIND
    bool "cplusplus unwind support"
    default n

endmenu
```

## lichee/rtos/components/thirdparty/elmfat/Kconfig
```kconfig
config COMPONENT_ELMFAT
    bool "elmfat"
    default n
    depends on COMPONENTS_AW_DEVFS
    help
      support elmfat

    if COMPONENT_ELMFAT
        menu "elm-chan's FatFs, Generic FAT Filesystem Module"
        config VFS_ELM_CODE_PAGE
            int "OEM code page"
            default 437

        config VFS_ELM_WORD_ACCESS
            bool "Using VFS_ELM_WORD_ACCESS"
            default y

        choice
            prompt "Support long file name"
            default VFS_ELM_USE_LFN_3

            config VFS_ELM_USE_LFN_0
                bool "0: LFN disable"

            config VFS_ELM_USE_LFN_1
                bool "1: LFN with static LFN working buffer"

            config VFS_ELM_USE_LFN_2
                bool "2: LFN with dynamic LFN working buffer on the stack"

            config VFS_ELM_USE_LFN_3
                bool "3: LFN with dynamic LFN working buffer on the heap"
        endchoice

        config VFS_ELM_USE_LFN
            int
            default 0 if VFS_ELM_USE_LFN_0
            default 1 if VFS_ELM_USE_LFN_1
            default 2 if VFS_ELM_USE_LFN_2
            default 3 if VFS_ELM_USE_LFN_3

        config VFS_ELM_MAX_LFN
            int "Maximal size of file name length"
            range 12 255
            default 255

        config VFS_ELM_DRIVES
            int "Number of volumes (logical drives) to be used."
            default 2

        config VFS_ELM_MAX_SECTOR_SIZE
            int "Maximum sector size to be handled."
            default 512
            help
                if you use some spi nor flash for fatfs, please set this the erase sector size, for example 4096.

        config VFS_ELM_USE_ERASE
            bool "Enable sector erase feature"
            default n

        config VFS_ELM_REENTRANT
            bool "Enable the reentrancy (thread safe) of the FatFs module"
            default y
        endmenu
        config VFS_SUPPORT_DIR
            bool "Enable Directory Support"
            default y

        config DRIVERS_SDMMC_FS_PATH
            string "/sdmmc"
    endif
```

## lichee/rtos/components/thirdparty/finsh_cli/Kconfig
```kconfig
menu "finsh cli"

config COMPONENT_FINSH_CLI
    bool "finsh cli"
    default y

if COMPONENT_FINSH_CLI

config FINSH_THREAD_NAME
    string "The finsh thread name"
    default "tshell"

config FINSH_USING_HISTORY
    bool "Enable command history feature"
    default y

if FINSH_USING_HISTORY
config FINSH_HISTORY_LINES
    int "The command history line number"
    default 5
endif

config FINSH_USING_DESCRIPTION
    bool "Keeping description in symbol table"
    default y

config FINSH_ECHO_DISABLE_DEFAULT
    bool "Disable the echo mode in default"
    default n

config FINSH_THREAD_PRIORITY
    int "The priority level value of finsh thread"
    default 20

config FINSH_THREAD_STACK_SIZE
    int "The stack size for finsh thread"
    default 8192

config FINSH_CMD_SIZE
    int "The command line size for shell"
    default 256

config FINSH_USING_AUTH
    bool "shell support authentication"
    default n

if FINSH_USING_AUTH
config FINSH_DEFAULT_PASSWORD
    string "The default password for shell authentication"
    default "rtthread"
config FINSH_PASSWORD_MIN
    int "The password min length"
    default 6
config FINSH_PASSWORD_MAX
    int "The password max length"
    default 32
config FINSH_ALLOW_SKIP_AUTH
    bool "skip auth by check finsh_is_auth_required()"
    default n
endif

config FINSH_ARG_MAX
    int "The command arg num for shell"
    default 10

endif
endmenu
```

## lichee/rtos/components/thirdparty/io_multiplex/Kconfig
```kconfig
menuconfig COMPONENT_IO_MULTIPLEX
    bool "IO Multiplex"
    default n
    help
        Enable IO Multiplex.
```

## lichee/rtos/components/thirdparty/lfs/Kconfig
```kconfig
config COMPONENT_LITTLEFS
    bool "LittleFS Filesystem"
    select COMPONENT_VFS
    select COMPONENTS_AW_BLKPART
    default y
    help
      LittleFS is a filesystem desigend by arm.

choice

    prompt "LFS Codes Version"
    depends on COMPONENT_LITTLEFS
    default COMPONENT_LITTLEFS_2_2_1

    config COMPONENT_LITTLEFS_2_2_1
        bool "v2.2.1"

endchoice

config COMPONENT_LITTLEFS_MAX_OPEN_FILES
    int "max opened files"
    depends on COMPONENT_LITTLEFS
    default 20
    help
      Max opened files at one time.
```

## lichee/rtos/components/thirdparty/sona_audioaef/Kconfig
```kconfig
config COMPONENT_SONA_AUDIOAEF
	bool "Sona audio effect"
	default n
	help
	  Sona audio effect library
```

## lichee/rtos/components/thirdparty/speex/Kconfig
```kconfig
menuconfig COMPONENT_SPEEX
    bool "SPEEX"
    default n
    help
        Enable SPEEX.
```

## lichee/rtos/components/thirdparty/testbench/Kconfig
```kconfig
config PROJECT_TEST_POSIX
    bool "run posix test"
    default n

config PROJECT_TEST_GENIE_CTS
    bool "run genie cts"
    default n
```
